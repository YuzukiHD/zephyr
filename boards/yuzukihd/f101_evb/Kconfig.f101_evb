## drivers/sdhc/Kconfig.sunxi
```kconfig
# Copyright (c) 2026 Yuzuki Tsuru
# SPDX-License-Identifier: Apache-2.0

config SDHC_SUNXI
	bool "Allwinner sunxi SD/MMC host controller"
	default y
	depends on DT_HAS_ALLWINNER_SUNXI_SMHC_ENABLED
	select PINCTRL
	select GPIO
	select CACHE_MANAGEMENT
	select SDHC_SUPPORTS_NATIVE_MODE
	help
	  Enable the Allwinner sunxi SMHC driver (SD, MMC and SDIO cards).

if SDHC_SUNXI

config SDHC_SUNXI_MAX_DESC
	int "Number of DMA descriptors"
	default 64
	range 2 1024
	help
	  Each descriptor moves up to 8 KiB, so this bounds the size of one
	  transfer done by DMA. Larger requests are rejected.

config SDHC_SUNXI_BOUNCE_KB
	int "Size of the bounce buffer in KiB"
	default 64
	help
	  Data transfers use the DMA engine, which needs cache-line aligned
	  memory. A transfer from or to other memory goes through a buffer of
	  this size (allocated from the kernel heap on first use), copied by the CPU; larger ones
	  are done by the CPU alone. 0 disables the bounce buffer.

endif # SDHC_SUNXI
```

## drivers/spi/Kconfig.sunxi
```kconfig
# Copyright (c) 2026 Yuzuki Tsuru
# SPDX-License-Identifier: Apache-2.0

config SPI_SUNXI
	bool "Allwinner sunxi SPI controller"
	default y
	depends on DT_HAS_ALLWINNER_SUNXI_SPI_ENABLED
	select PINCTRL
	help
	  Enable the polling master-mode SPI driver for Allwinner sunxi SPI.

config SPI_SUNXI_INIT_PRIORITY
	int "Allwinner sunxi SPI init priority"
	default 81

config SPI_SUNXI_DMA
	bool "Receive long reads with DMA"
	default y
	depends on SPI_SUNXI && DMA
	help
	  Reads of at least SPI_SUNXI_DMA_MIN_LEN bytes into a 4 byte aligned
	  buffer are moved by the DMA controller (the node needs 'dmas').

config SPI_SUNXI_DMA_MIN_LEN
	int "Shortest read that uses the DMA"
	default 256
	depends on SPI_SUNXI_DMA
```
