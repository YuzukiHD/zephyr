## boards/yuzukihd/f101_evb/Kconfig.f101_evb
```kconfig
# Copyright (c) 2026 Yuzuki Tsuru
# SPDX-License-Identifier: Apache-2.0

config BOARD_F101_EVB
	bool "YuzukiHD F101 EVB"
	select SOC_SUN252I_F101
```

## boards/yuzukihd/f101_evb/board.yml
```yaml
# Copyright (c) 2026 Yuzuki Tsuru
# SPDX-License-Identifier: Apache-2.0

board:
  name: f101_evb
  full_name: YuzukiHD F101 EVB
  vendor: yuzukihd
  socs:
  - name: sun252i_f101
```

## boards/yuzukihd/yuzukineko/Kconfig.yuzukineko
```kconfig
# Copyright (c) 2026 Yuzuki Tsuru
# SPDX-License-Identifier: Apache-2.0

config BOARD_YUZUKINEKO
	bool "YuzukiHD YuzukiNeko"
	select SOC_SUN252I_F101
```

## boards/yuzukihd/yuzukineko/board.yml
```yaml
# Copyright (c) 2026 Yuzuki Tsuru
# SPDX-License-Identifier: Apache-2.0

board:
  name: yuzukineko
  full_name: YuzukiHD YuzukiNeko
  vendor: yuzukihd
  socs:
  - name: sun252i_f101
```

## boards/yuzukihd/yuzukineko/yuzukineko_defconfig
```kconfig
# Copyright (c) 2026 Yuzuki Tsuru
# SPDX-License-Identifier: Apache-2.0

CONFIG_SERIAL=y
CONFIG_UART_INTERRUPT_DRIVEN=y
CONFIG_CONSOLE=y
CONFIG_UART_CONSOLE=y
CONFIG_PINCTRL=y
CONFIG_GPIO=y
CONFIG_CLOCK_CONTROL=y
CONFIG_RESET=y
CONFIG_DYNAMIC_INTERRUPTS=y
CONFIG_I2C=y
CONFIG_SPI=y
CONFIG_SHELL=y
CONFIG_DEBUG=y
CONFIG_LOG=y
CONFIG_LOG_MAX_LEVEL=4
CONFIG_LOG_DEFAULT_LEVEL=4
CONFIG_LOG_OVERRIDE_LEVEL=4
CONFIG_LOG_MODE_IMMEDIATE=y
CONFIG_LOG_BACKEND_UART=y
CONFIG_LOG_PRINTK=y
CONFIG_DEVMEM_SHELL=y
```

## drivers/adc/Kconfig.sunxi
```kconfig
# Copyright (c) 2026 Yuzuki Tsuru
# SPDX-License-Identifier: Apache-2.0

config ADC_SUNXI
	bool "Allwinner sunxi GPADC"
	default y
	depends on DT_HAS_ALLWINNER_SUNXI_GPADC_ENABLED
	help
	  Enable the polling ADC driver for the Allwinner sunxi GPADC.

config ADC_SUNXI_INIT_PRIORITY
	int "Allwinner sunxi GPADC init priority"
	default 82

config ADC_SUNXI_READ_TIMEOUT_US
	int "Allwinner sunxi GPADC conversion timeout"
	default 10000
	range 100 1000000
	help
	  Maximum time to wait for one conversion result.
```

## drivers/audio/Kconfig.sunxi
```kconfig
# Copyright (c) 2026 Yuzuki Tsuru
# SPDX-License-Identifier: Apache-2.0

config AUDIO_CODEC_SUNXI
	bool "Allwinner sunxi on-chip audio codec, analog front end"
	default y
	depends on DT_HAS_ALLWINNER_SUNXI_CODEC_ANALOG_ENABLED
	select GPIO
	help
	  Headphone / speaker output, microphone, line and FM inputs and the
	  volume controls of the on-chip audio codec. The sample streams are
	  provided by the I2S_SUNXI_CODEC driver.
```

## drivers/clock_control/Kconfig.sunxi
```kconfig
# Copyright (c) 2026 Yuzuki Tsuru
# SPDX-License-Identifier: Apache-2.0

config CLOCK_CONTROL_SUNXI
	bool "Allwinner sunxi CCU bus clock driver"
	default y
	depends on DT_HAS_ALLWINNER_SUNXI_CCTL_ENABLED
	help
	  Enable driver for the Allwinner sunxi system CCU bus
	  clock gates.
```

## drivers/display/Kconfig.sunxi
```kconfig
# Allwinner display-engine / TCON display stack

# SPDX-License-Identifier: Apache-2.0 OR GPL-2.0-or-later

config DISPLAY_SUNXI
	bool "Allwinner display engine + TCON display driver"
	default y
	depends on DT_HAS_ALLWINNER_SUNXI_DISPLAY_ENABLED
	depends on SOC_SUN252I_F101
	select CACHE_MANAGEMENT
	select DYNAMIC_INTERRUPTS
	imply PWM
	help
	  Display stack of the Allwinner F101 (display engine, timing
	  controller, RGB/LVDS/DSI encoders, panels, backlights) exposed as a
	  Zephyr display device. The stack allocates its register command
	  queue and shadow registers from the kernel heap, so
	  HEAP_MEM_POOL_SIZE must be large enough (256 KiB is enough for the
	  RGB configuration).

if DISPLAY_SUNXI

choice DISPLAY_SUNXI_PIXEL_FORMAT
	prompt "Framebuffer pixel format"
	default DISPLAY_SUNXI_RGB565

config DISPLAY_SUNXI_RGB565
	bool "RGB565"

config DISPLAY_SUNXI_ARGB8888
	bool "ARGB8888"

endchoice

config DISPLAY_SUNXI_READY_TIMEOUT_MS
	int "Time to wait for the boot modeset"
	default 5000

menu "Display pipeline options"

config DISPLAY_SOC_SUN252IW2
	bool "Allwinner sun252iw2 (F101) hardware description"
	default y
	help
	  Hardware graph of the SoC: register windows, clocks, resets,
	  interrupts and links between the display engine, TCON and encoders.

config DISPLAY_DE
	bool "Display engine 2.x"
	default y

config DISPLAY_DE_WRITEBACK
	bool "Write-back (capture) support"
	depends on DISPLAY_DE
	default y

config DISPLAY_TCON_LCD
	bool "TCON LCD timing controller"
	default y

config DISPLAY_ENCODER_RGB
	bool "Parallel RGB (HV) screens"
	depends on DISPLAY_TCON_LCD
	default y

config DISPLAY_ENCODER_LVDS
	bool "LVDS screens"
	depends on DISPLAY_TCON_LCD
	select DISPLAY_COMBO_DPHY
	default y

config DISPLAY_ENCODER_DSI
	bool "MIPI DSI screens"
	depends on DISPLAY_TCON_LCD
	select DISPLAY_COMBO_DPHY
	default y

config DISPLAY_COMBO_DPHY
	bool
	help
	  Combo D-PHY shared by the DSI and LVDS encoders.

config DISPLAY_PANEL_SIMPLE
	bool "Simple RGB/LVDS panel driver"
	default y

config DISPLAY_PANEL_SPI_INIT
	bool "Bit-banged SPI init sequences for simple panels"
	depends on DISPLAY_PANEL_SIMPLE
	default y

config DISPLAY_PANEL_DSI
	bool "Generic MIPI DSI panel driver"
	depends on DISPLAY_ENCODER_DSI
	default y

config DISPLAY_BACKLIGHT_GPIO
	bool "GPIO backlight"
	default y

config DISPLAY_BACKLIGHT_PWM
	bool "PWM backlight"
	default y

config DISPLAY_BOOT_COLORBAR
	bool "Show the TCON colour bar at boot"
	help
	  Bring-up aid: proves clocks, pins and panel timing without the
	  display engine.

config DISPLAY_SHELL_CMDS
	bool "Shell commands (display ...)"
	default y
	depends on SHELL
	help
	  "display info|graph|regs|stats|log|backlight|blank" for inspecting
	  and driving the pipeline.

config HAL_TEST_DISPLAY_ENGINE
	bool "display-engine self test commands (display_test ...)"
	depends on DISPLAY_SHELL_CMDS
	help
	  Build debug/display_test.c (needs an OS specific shell front-end).

endmenu

endif # DISPLAY_SUNXI
```

## drivers/dma/Kconfig.sunxi
```kconfig
# Copyright (c) 2026 Yuzuki Tsuru
# SPDX-License-Identifier: Apache-2.0

config DMA_SUNXI
	bool "Allwinner sunxi legacy DMA"
	default y
	depends on DT_HAS_ALLWINNER_SUNXI_DMA_ENABLED
	select CACHE_MANAGEMENT
	help
	  Enable the F101 12-channel LLI DMA controller.

config DMA_SUNXI_MAX_BLOCKS
	int "Allwinner sunxi DMA blocks per channel"
	default 8
	range 1 64
	depends on DMA_SUNXI
	help
	  Number of chained blocks a channel can hold. A cyclic transfer (an
	  audio ring) uses one block per period.

config DMA_SUNXI_INIT_PRIORITY
	int "Allwinner sunxi DMA initialization priority"
	default 50
```

## drivers/flash/Kconfig.sunxi_spif
```kconfig
# Copyright (c) 2026 Yuzuki Tsuru
# SPDX-License-Identifier: Apache-2.0

config FLASH_SUNXI_SPIF
	bool "Allwinner SPIF SPI NOR flash controller"
	default y
	depends on DT_HAS_ALLWINNER_SUNXI_SPIF_ENABLED
	select PINCTRL
	select RESET
	select CRC
	select FLASH_HAS_DRIVER_ENABLED
	select FLASH_HAS_PAGE_LAYOUT
	select FLASH_HAS_EXPLICIT_ERASE
	help
	  Enable the driver of the Allwinner SPIF controller: JEDEC SPI NOR
	  flash with 1/4 wire reads and page programs, sample point tuning,
	  stored tuning results and the XIP memory window.

if FLASH_SUNXI_SPIF

config FLASH_SUNXI_SPIF_INIT_PRIORITY
	int "Init priority"
	default 50

config FLASH_SUNXI_SPIF_TUNE_MIN_WINDOW
	int "Narrowest accepted window of sample delay steps"
	default 8
	range 1 64
	help
	  A window narrower than this is not trusted (temperature and voltage
	  move it) and the tuning tries a lower frequency.

config FLASH_SUNXI_SPIF_TUNE_AT_INIT
	bool "Tune the sample point at init when no result is stored"
	default y
	help
	  The flash is read at 24 MHz and at the configured frequency with
	  every sample mode and delay, the widest window of correct reads is
	  used, and the result is stored when the node has a params
	  partition. Without it the controller stays at 24 MHz.

config FLASH_SUNXI_SPIF_XIP_AT_INIT
	bool "Map the xip-partition into the address space at init"
	help
	  Needs the 'xip-partition' property of the node.

config FLASH_SUNXI_SPIF_XIP_SECTIONS
	bool "Link code and data into the XIP window"
	depends on FLASH_SUNXI_SPIF_XIP_AT_INIT
	help
	  Functions marked __xip_text and constants marked __xip_rodata
	  (zephyr/drivers/flash/flash_sunxi_spif.h) are linked at the address
	  of the memory window and run from the flash. Their image is part of
	  the flat image; at init the driver compares it with the xip-partition
	  and programs the partition when it differs, then maps it.

config FLASH_SUNXI_SPIF_XIP_BASE
	hex "Address of the XIP window"
	default 0x0e000000
	help
	  Must be the base of the "xip" register block of the node.

endif # FLASH_SUNXI_SPIF
```

## drivers/g2d/Kconfig
```kconfig
# Copyright (c) 2026 Yuzuki Tsuru
# SPDX-License-Identifier: Apache-2.0

menuconfig G2D
	bool "2D graphics accelerator (G2D) drivers"
	help
	  Enable the G2D API and drivers: hardware fill, copy with format
	  conversion, scaling, rotation and alpha blending of memory buffers.

if G2D

config G2D_INIT_PRIORITY
	int "G2D init priority"
	default 41
	help
	  Initialization priority of the G2D drivers in the POST_KERNEL level.

config G2D_SHELL
	bool "G2D shell commands (g2d ...)"
	depends on SHELL
	default y
	help
	  "g2d info|fill|blit|blend|bench" to exercise the accelerator and
	  compare it with the CPU.

module = G2D
module-str = g2d
source "subsys/logging/Kconfig.template.log_config"

rsource "Kconfig.sunxi"

endif # G2D
```

## drivers/g2d/Kconfig.sunxi
```kconfig
# Copyright (c) 2026 Yuzuki Tsuru
# SPDX-License-Identifier: Apache-2.0

config G2D_SUNXI
	bool "Allwinner sunxi G2D"
	default y
	depends on DT_HAS_ALLWINNER_SUNXI_G2D_ENABLED
	select CACHE_MANAGEMENT
	help
	  Driver of the Allwinner G2D (mixer and rotate engine fed by a
	  register command queue). The driver is GPL-2.0-or-later.

if G2D_SUNXI

config G2D_SUNXI_THREAD_STACK_SIZE
	int "Stack size of the G2D worker thread"
	default 2048

config G2D_SUNXI_THREAD_PRIORITY
	int "Priority of the G2D worker thread"
	default 5

config G2D_SUNXI_TIMEOUT_MS
	int "Time in milliseconds one operation may take"
	default 100

endif # G2D_SUNXI
```

## drivers/gpio/Kconfig.sunxi
```kconfig
# Copyright (c) 2026 Yuzuki Tsuru
# SPDX-License-Identifier: Apache-2.0

config GPIO_SUNXI
	bool "Allwinner sunxi PIO GPIO driver"
	default y
	depends on DT_HAS_ALLWINNER_SUNXI_GPIO_ENABLED
	help
	  Enable driver for the Allwinner sunxi PIO GPIO
	  controller. The controller provides 6 banks (PA..PF) with 32 pins
	  each and per-bank interrupts.
```

## drivers/i2c/Kconfig.sunxi
```kconfig
# Copyright (c) 2026 Yuzuki Tsuru
# SPDX-License-Identifier: Apache-2.0

config I2C_SUNXI
	bool "Allwinner sunxi TWI controller"
	default y
	depends on DT_HAS_ALLWINNER_SUNXI_TWI_ENABLED
	select PINCTRL
	help
	  Enable the polling master-mode I2C driver for Allwinner sunxi TWI.

config I2C_SUNXI_INIT_PRIORITY
	int "Allwinner sunxi TWI init priority"
	default 81
```

## drivers/i2s/Kconfig.sunxi
```kconfig
# Copyright (c) 2026 Yuzuki Tsuru
# SPDX-License-Identifier: Apache-2.0

config I2S_SUNXI_STREAM
	bool
	select DMA
	select CACHE_MANAGEMENT
	help
	  DMA ring and queue handling shared by the sunxi audio interfaces.

config I2S_SUNXI_QUEUE_LEN
	int "Allwinner sunxi audio queue length"
	default 8
	depends on I2S_SUNXI_STREAM
	help
	  Number of memory blocks that can wait in the queue of a stream.

config I2S_SUNXI_CODEC
	bool "Allwinner sunxi on-chip audio codec streams"
	default y
	depends on DT_HAS_ALLWINNER_SUNXI_CODEC_ENABLED
	select I2S_SUNXI_STREAM
	help
	  Playback (DAC) and capture (ADC) streams of the on-chip audio codec
	  through the I2S API. The analog side is the AUDIO_CODEC_SUNXI driver.

config I2S_SUNXI
	bool "Allwinner sunxi I2S controller"
	default y
	depends on DT_HAS_ALLWINNER_SUNXI_I2S_ENABLED
	select I2S_SUNXI_STREAM
	select PINCTRL
	help
	  Enable the I2S / PCM / TDM controller of the Allwinner sunxi SoCs.

config I2S_SUNXI_OWA
	bool "Allwinner sunxi one-wire audio (S/PDIF)"
	default y
	depends on DT_HAS_ALLWINNER_SUNXI_OWA_ENABLED
	select I2S_SUNXI_STREAM
	select PINCTRL
	help
	  Enable the S/PDIF transmitter and receiver of the Allwinner sunxi SoCs.
```

## drivers/input/Kconfig.gt967
```kconfig
# Copyright (c) 2026 Yuzuki Tsuru
# SPDX-License-Identifier: Apache-2.0

menuconfig INPUT_GT967
	bool "GT967 capacitive touch panel driver"
	default y
	depends on DT_HAS_GOODIX_GT967_ENABLED
	select I2C
	select INPUT_TOUCH
	help
	  Enable driver for the Goodix GT967 capacitive touch controller
	  (up to 5 touch points).

if INPUT_GT967

config INPUT_GT967_INTERRUPT
	bool "Interrupt"
	default y
	help
	  Read the touch data when the INT line signals it. Without it the
	  controller is polled.

config INPUT_GT967_PERIOD_MS
	int "Sample period"
	depends on !INPUT_GT967_INTERRUPT
	default 10
	help
	  Sample period in milliseconds when in polling mode.

config INPUT_GT967_MAX_TOUCH_POINTS
	int "Touch Number"
	default 1
	range 1 5
	help
	  Maximum number of touch points to be handled. Multitouch is ignored
	  if equal to 1.

endif # INPUT_GT967
```

## drivers/mipi_dbi/Kconfig.sunxi
```kconfig
# Copyright (c) 2026 Yuzuki Tsuru
# SPDX-License-Identifier: Apache-2.0

config MIPI_DBI_SUNXI
	bool "Allwinner sunxi SPI DBI host"
	default y
	depends on DT_HAS_ALLWINNER_SUNXI_DBI_ENABLED
	select DMA
	select SPI
	select PINCTRL
	help
	  Enable the Allwinner F101 DBI host implemented by the SPI1 controller.

config MIPI_DBI_SUNXI_INIT_PRIORITY
	int "Allwinner sunxi DBI init priority"
	default 80

config MIPI_DBI_SUNXI_TIMEOUT_US
	int "Allwinner sunxi DBI transfer timeout"
	default 100000
	range 1000 5000000
```

## drivers/misc/mbus_sunxi/Kconfig
```kconfig
# Copyright (c) 2026 Yuzuki Tsuru
# SPDX-License-Identifier: Apache-2.0 OR GPL-2.0-or-later

config MBUS_SUNXI
	bool "Allwinner sunxi memory bus (MBUS) driver"
	default y
	depends on DT_HAS_ALLWINNER_SUNXI_MBUS_ENABLED
	help
	  Programs the arbitration priority and bandwidth limit of the bus
	  masters from the devicetree and exposes the bandwidth monitor.

if MBUS_SUNXI

config MBUS_SUNXI_INIT_PRIORITY
	int "MBUS init priority"
	default 40
	help
	  Must be lower than the display (DISPLAY_INIT_PRIORITY) so that the
	  priorities are in place before the display engine starts.

config MBUS_SUNXI_SHELL
	bool "MBUS shell commands (mbus ...)"
	default y
	depends on SHELL
	help
	  "mbus stats|prio|limit" to read the bandwidth of the masters and to
	  change their priority and limit at run time.

module = MBUS_SUNXI
module-str = mbus_sunxi
source "subsys/logging/Kconfig.template.log_config"

endif # MBUS_SUNXI
```

## drivers/pinctrl/Kconfig.sunxi
```kconfig
# Copyright (c) 2026 Yuzuki Tsuru
# SPDX-License-Identifier: Apache-2.0

config PINCTRL_SUNXI
	bool "Allwinner sunxi PIO pinmux driver"
	default y
	depends on DT_HAS_ALLWINNER_SUNXI_PINCTRL_ENABLED
	help
	  Enable driver for the Allwinner sunxi PIO pin
	  controller.
```

## drivers/pwm/Kconfig.sunxi
```kconfig
# Copyright (c) 2026 Yuzuki Tsuru
# SPDX-License-Identifier: Apache-2.0

config PWM_SUNXI
	bool "Allwinner sunxi PWM-ng controller"
	default y
	depends on DT_HAS_ALLWINNER_SUNXI_PWM_ENABLED
	select PINCTRL
	help
	  Enable the Allwinner sunxi PWM-ng controller.

config PWM_SUNXI_INIT_PRIORITY
	int "Allwinner sunxi PWM init priority"
	default 82

config PWM_SUNXI_BL
	bool "Allwinner sunxi PWM_BL backlight controller"
	default y
	depends on DT_HAS_ALLWINNER_SUNXI_PWM_BL_ENABLED
	select PINCTRL
	help
	  Enable the Allwinner PWM_BL backlight block (digital dimming and
	  analog current sink) used to drive LCD backlights on the F101.

config PWM_SUNXI_BL_INIT_PRIORITY
	int "Allwinner sunxi PWM_BL init priority"
	default 82
	depends on PWM_SUNXI_BL
```

## drivers/reset/Kconfig.sunxi
```kconfig
# Copyright (c) 2026 Yuzuki Tsuru
# SPDX-License-Identifier: Apache-2.0

config RESET_SUNXI
	bool "Allwinner sunxi CCU reset driver"
	default y
	depends on DT_HAS_ALLWINNER_SUNXI_RCTL_ENABLED
	help
	  Enable driver for the Allwinner sunxi system CCU
	  reset lines.
```
