## samples/drivers/display/Kconfig
```kconfig
# SPDX-License-Identifier: Apache-2.0

mainmenu "Display sample"

config SAMPLE_DISPLAY_COLOR_BARS
	bool "Draw colour bars instead of the corner rectangles"
	help
	  Eight vertical colour bars (red, green, blue, white, black, yellow,
	  cyan, magenta) over three quarters of the screen, a grey ramp below and
	  a one pixel white frame, for checking the picture of a new panel.
	  Needs a 32 bit ARGB frame buffer.

source "Kconfig.zephyr"
```

## samples/drivers/vdec/png/sample.yaml
```yaml
sample:
  name: Hardware PNG decoder
tests:
  sample.drivers.vdec.png:
    platform_allow:
      - f101_evb
    tags: vdec
    harness: console
    harness_config:
      type: one_line
      regex:
        - "png decode done"
```

## samples/subsys/input/draw_touch_events/Kconfig
```kconfig
# Copyright (c) 2024 Antmicro <www.antmicro.com>
# SPDX-License-Identifier: Apache-2.0

config SCREEN_WIDTH_TO_CROSS_DIM
	int "Screen width to cross horizontal/vertical dimension ratio"
	default 25

config SAMPLE_REFRESH_PERIOD_MS
	int "Minimum time between two redraws in milliseconds"
	default 100

source "Kconfig.zephyr"
```

## soc/allwinner/sun252i_f101/Kconfig
```kconfig
# Copyright (c) 2026 Yuzuki Tsuru
# SPDX-License-Identifier: Apache-2.0

config SOC_SUN252I_F101
	bool
	select RISCV
	select RISCV_PRIVILEGED
	select RISCV_HAS_PLIC
	select RISCV_VECTORED_MODE
	select GEN_IRQ_VECTOR_TABLE
	select INCLUDE_RESET_VECTOR
	select RISCV_ISA_RV32I
	select RISCV_ISA_EXT_M
	select RISCV_ISA_EXT_A
	select RISCV_ISA_EXT_C
	select RISCV_ISA_EXT_F
	select RISCV_ISA_EXT_D
	select CPU_HAS_FPU_DOUBLE_PRECISION
	select RISCV_ISA_EXT_ZICSR
	select RISCV_ISA_EXT_ZIFENCEI
	select RISCV_ISA_EXT_XTHEADCMO
	select CPU_HAS_ICACHE
	select CPU_HAS_DCACHE
	select SOC_EARLY_INIT_HOOK
	select CACHE_MANAGEMENT
	help
	  Allwinner sun252i (F101) SoC, single Xuantie C907 (rv32imafdcv) core
	  with PLIC and CLINT, no MMU, no external DDR (internal SRAM/PSRAM only).

config SUN252I_F101_RVV
	bool "Vector extension (RVV 1.0)"
	depends on SOC_SUN252I_F101
	select RISCV_ISA_EXT_V
	select RISCV_ISA_EXT_ZICSR
	select RISCV_SOC_CONTEXT_SAVE
	help
	  Build the image with the V extension and preserve the vector
	  registers in every interrupt and exception frame, so threads and
	  interrupt handlers can all use the vector unit. It costs about
	  VLEN/8*32 + 32 bytes of stack for each interrupt level.

config SUN252I_F101_MMU
	bool "Sv32 MMU"
	depends on SOC_SUN252I_F101
	select RISCV_MMU
	help
	  Run the kernel with the Sv32 MMU in the way described at RISCV_MMU.
	  The image and the peripherals are mapped 1:1 and the rest of the
	  RAM is page frames for k_mem_map() and demand paging. Memory that a
	  driver hands to a DMA engine or to the cache operations must be
	  mapped 1:1: the static image (including the heap arenas), not
	  pages from k_mem_map(). Set a finite
	  COMMON_LIBC_MALLOC_ARENA_SIZE: the default of all the free RAM
	  would be taken from the page frames.

config SUN252I_F101_VLEN
	int "Vector register length in bits"
	depends on SUN252I_F101_RVV
	default 128
	help
	  VLEN of the C907 vector unit, checked against the vlenb CSR at boot.
```

## soc/allwinner/sun252i_f101/Kconfig.defconfig
```kconfig
# Copyright (c) 2026 Yuzuki Tsuru
# SPDX-License-Identifier: Apache-2.0

if SOC_SUN252I_F101

config NUM_IRQS
	default 204

config SYS_CLOCK_HW_CYCLES_PER_SEC
	default $(dt_node_int_prop_int,/cpus,timebase-frequency)

config 2ND_LVL_ISR_TBL_OFFSET
	default 12

config 2ND_LVL_INTR_00_OFFSET
	default 11

config MAX_IRQ_PER_AGGREGATOR
	default 192

config ICACHE_LINE_SIZE
	default 64

config DCACHE_LINE_SIZE
	default 64

if SUN252I_F101_RVV

# Every interrupt and exception frame carries the vector registers (about
# 32 * VLEN/8 + 32 bytes), each thread stack has to hold one plus the handler.
config IDLE_STACK_SIZE
	default 1536

config MAIN_STACK_SIZE
	default 4096

config ISR_STACK_SIZE
	default 4096

config SYSTEM_WORKQUEUE_STACK_SIZE
	default 2048

config LOG_PROCESS_THREAD_STACK_SIZE
	default 2048

config TEST_EXTRA_STACK_SIZE
	default 1024

endif # SUN252I_F101_RVV

if SERIAL

config UART_NS16550
	default y

config UART_NS16550_DW8250_DW_APB
	default y

endif # SERIAL

endif # SOC_SUN252I_F101
```

## soc/allwinner/sun252i_f101/Kconfig.soc
```kconfig
# Copyright (c) 2026 Yuzuki Tsuru
# SPDX-License-Identifier: Apache-2.0

config SOC_SUN252I_F101
	bool

config SOC
	default "sun252i_f101" if SOC_SUN252I_F101
```
