## CMakeLists.txt
```
# Copyright (c) 2026 Yuzuki Tsuru
# SPDX-License-Identifier: Apache-2.0

cmake_minimum_required(VERSION 3.20.0)
find_package(Zephyr REQUIRED HINTS $ENV{ZEPHYR_BASE})
project(vdec_h264_player)

target_sources(app PRIVATE src/main.c src/overlay.c)
target_include_directories(app PRIVATE ${CMAKE_CURRENT_SOURCE_DIR}/../common)
```

## Kconfig
```
# Copyright (c) 2026 Yuzuki Tsuru
# SPDX-License-Identifier: Apache-2.0

mainmenu "H.264 file player"

config SAMPLE_PLAYER_FILE
	string "Annex B H.264 file on the SD card"
	default "/SD:/badapple.h264"

config SAMPLE_PLAYER_FPS_NUM
	int "Frame rate, numerator"
	default 30000

config SAMPLE_PLAYER_FPS_DEN
	int "Frame rate, denominator"
	default 1001

config SAMPLE_PLAYER_REALTIME
	bool "Show the frames at the frame rate"
	default y
	help
	  Without it the clip is decoded as fast as possible and every frame is
	  shown at once, which measures what the decoder can do.

source "Kconfig.zephyr"
```

## sample.yaml
```
sample:
  name: H.264 file player
tests:
  sample.drivers.vdec.h264_player:
    platform_allow:
      - f101_evb
    tags: vdec sdhc
```

## prj.conf
```kconfig
CONFIG_FPU=y
CONFIG_FPU_SHARING=y
CONFIG_VDEC=y
CONFIG_SDHC=y
CONFIG_DISK_ACCESS=y
CONFIG_DISK_DRIVER_SDMMC=y
CONFIG_FILE_SYSTEM=y
CONFIG_FAT_FILESYSTEM_ELM=y
CONFIG_FS_FATFS_EXFAT=y
CONFIG_FS_FATFS_LFN=y
CONFIG_FS_FATFS_LFN_MODE_STACK=y
CONFIG_LOG=y
CONFIG_LOG_PRINTK=n
CONFIG_PRINTK=y
CONFIG_SHELL=n
CONFIG_DEVMEM_SHELL=n
CONFIG_MAIN_STACK_SIZE=8192
CONFIG_COMMON_LIBC_MALLOC_ARENA_SIZE=-1
CONFIG_HEAP_MEM_POOL_SIZE=262144

# The statistics overlay: LVGL on the ARGB frame buffer plane, over the video plane
CONFIG_DISPLAY=y
CONFIG_DISPLAY_SUNXI_ARGB8888=y
CONFIG_LVGL=y
CONFIG_LV_COLOR_DEPTH_32=y
CONFIG_LV_Z_MEM_POOL_SIZE=131072
CONFIG_LV_USE_CHART=y
CONFIG_LV_Z_VDB_SIZE=4
CONFIG_LV_FONT_MONTSERRAT_16=y
CONFIG_LV_Z_SHELL=n

# only the statistics panel (top left) is on the frame buffer plane: do not scan the rest
CONFIG_DISPLAY_SUNXI_FB_WINDOW_WIDTH=400
CONFIG_DISPLAY_SUNXI_FB_WINDOW_HEIGHT=400
```

## src/main.c
```c
/*
 * Copyright (c) 2026 Yuzuki Tsuru
 *
 * SPDX-License-Identifier: Apache-2.0
 */

/*
 * Play an H.264 elementary stream (Annex B) from the FAT file system on the SD
 * card: the file is read in chunks, handed to the hardware decoder, and each
 * decoded frame is scanned out by the display engine at the frame rate.
 */

#include <ff.h>
#include <stdlib.h>
#include <string.h>
#include <zephyr/device.h>
#include <zephyr/drivers/display.h>
#include <zephyr/drivers/display/display_sunxi.h>
#include <zephyr/drivers/vdec.h>
#include <zephyr/fs/fs.h>
#include <zephyr/kernel.h>
#include <zephyr/sys/printk.h>

#include "overlay.h"

#define MOUNT_PT	"/SD:"
/* must hold the largest NAL unit of the stream (a detailed IDR frame can be 200 KiB) */
#define CHUNK_SIZE	(512 * 1024)
#define LATE_RESYNC_MS	150
#define REPORT_MS	5000

static FATFS fat_fs;
static struct fs_mount_t mp = {
	.type = FS_FATFS,
	.fs_data = &fat_fs,
	.mnt_point = MOUNT_PT,
};

/* Offset of the last Annex B start code (with its leading zero) in the data, -1 if none */
static int last_start_code(const uint8_t *p, size_t len)
{
	for (size_t i = len; i >= 4; i--) {
		if (p[i - 3] == 0 && p[i - 2] == 0 && p[i - 1] == 1) {
			size_t pos = i - 3;

			return (pos > 0 && p[pos - 1] == 0) ? (int)pos - 1 : (int)pos;
		}
	}

	return -1;
}

static void show(const struct device *disp, const struct vdec_frame *f)
{
	struct display_sunxi_yuv yuv = {
		.y = f->plane[0],
		.uv = f->plane[1],
		.width = f->width,
		.height = f->height,
		.stride_y = f->stride[0],
		.stride_uv = f->stride[1],
		.bt709 = true,
		/* unpaced playback measures the decoder, not the refresh rate */
		.nonblock = !IS_ENABLED(CONFIG_SAMPLE_PLAYER_REALTIME),
	};

	display_sunxi_show_yuv(disp, &yuv);
}

int main(void)
{
	const struct device *dev = DEVICE_DT_GET(DT_NODELABEL(ve));
	const struct device *disp = DEVICE_DT_GET(DT_CHOSEN(zephyr_display));
	const struct vdec_stream_config cfg = {
		.codec = VDEC_CODEC_H264,
		.format = VDEC_FORMAT_NV12,
		.buffer_size = 1024 * 1024,
	};
	struct vdec_frame frame, shown = {0}, older = {0};
	struct vdec_stream *stream;
	struct fs_file_t file;
	uint8_t *buf;
	size_t have = 0;
	bool eof = false, flushed = false;
	int frames = 0, late = 0, stalls = 0, ret;
	int64_t start, last_report, bytes_total = 0;
	int report_frames = 0;
	uint32_t report_decode_us = 0;

	if (!device_is_ready(dev) || !device_is_ready(disp)) {
		printk("decoder or display not ready\n");
		return 0;
	}
	ret = fs_mount(&mp);
	if (ret != 0) {
		printk("cannot mount the card: %d\n", ret);
		return 0;
	}
	fs_file_t_init(&file);
	ret = fs_open(&file, CONFIG_SAMPLE_PLAYER_FILE, FS_O_READ);
	if (ret != 0) {
		printk("cannot open %s: %d\n", CONFIG_SAMPLE_PLAYER_FILE, ret);
		return 0;
	}
	buf = aligned_alloc(64, CHUNK_SIZE);
	if (buf == NULL) {
		printk("no memory\n");
		return 0;
	}
	ret = vdec_stream_open(dev, &cfg, &stream);
	if (ret != 0) {
		printk("cannot open the stream: %d\n", ret);
		return 0;
	}

	printk("playing %s\n", CONFIG_SAMPLE_PLAYER_FILE);
	start = last_report = k_uptime_get();
	overlay_start();
	while (true) {
		int64_t t0 = k_uptime_ticks();

		ret = vdec_stream_get_frame(dev, stream, &frame);
		play_stats.decode_us += k_ticks_to_us_near32((uint32_t)(k_uptime_ticks() - t0));
		if (ret == 0) {
			int64_t due = start + (int64_t)frames * 1000 * CONFIG_SAMPLE_PLAYER_FPS_DEN /
						      CONFIG_SAMPLE_PLAYER_FPS_NUM;
			int64_t now = k_uptime_get();

			if (IS_ENABLED(CONFIG_SAMPLE_PLAYER_REALTIME)) {
				if (now > due + LATE_RESYNC_MS) {
					late++;
					play_stats.late = late;
					start += now - due;
				} else if (now < due) {
					k_sleep(K_TIMEOUT_ABS_MS(due));
				}
			}
			show(disp, &frame);
			/*
			 * The picture before the last one may still be on the screen when
			 * the new one does not wait for the refresh: let go of it one step late.
			 */
			if (older.priv != NULL) {
				vdec_frame_release(dev, &older);
			}
			if (IS_ENABLED(CONFIG_SAMPLE_PLAYER_REALTIME)) {
				if (shown.priv != NULL) {
					vdec_frame_release(dev, &shown);
				}
			} else {
				older = shown;
			}
			shown = frame;
			play_stats.width = frame.width;
			play_stats.height = frame.height;
			play_stats.frames = frames + 1;
			frames++;
			report_frames++;
			stalls = 0;

			now = k_uptime_get();
			if (now - last_report >= REPORT_MS) {
				int ms = (int)(now - last_report);

				uint32_t us = play_stats.decode_us - report_decode_us;

				printk("%d frames, %d.%02d fps, decoder %u us/frame, %d late, read %lld KiB\n",
				       frames, report_frames * 1000 / ms,
				       (report_frames * 100000 / ms) % 100,
				       report_frames ? us / report_frames : 0, late, bytes_total / 1024);
				last_report = now;
				report_frames = 0;
				report_decode_us = play_stats.decode_us;
			}
			continue;
		}
		if (ret == -ENODATA) {
			break;
		}
		if (ret == -EBUSY) {
			k_msleep(5);
			continue;
		}
		if (ret != -EAGAIN) {
			printk("decode error %d after %d frames\n", ret, frames);
			break;
		}

		/* the decoder wants data */
		if (!eof && have < CHUNK_SIZE) {
			ssize_t n = fs_read(&file, buf + have, CHUNK_SIZE - have);

			if (n < 0) {
				printk("read error %d\n", (int)n);
				break;
			}
			if (n == 0) {
				eof = true;
			}
			have += n;
			bytes_total += n;
			play_stats.sd_bytes += n;
		}
		if (have > 0) {
			/* only whole NAL units: up to the last start code, or all at the end */
			int cut = eof ? (int)have : last_start_code(buf, have);
			size_t used = 0;

			if (cut > 0) {
				ret = vdec_stream_feed(dev, stream, buf, cut, -1, &used);
				if (ret != 0 && ret != -EAGAIN) {
					printk("feed error %d\n", ret);
					break;
				}
			}
			if (used > 0) {
				memmove(buf, buf + used, have - used);
				have -= used;
				stalls = 0;
			} else if (have == CHUNK_SIZE && cut <= 0) {
				printk("a NAL unit is larger than %d KiB, raise CHUNK_SIZE\n",
				       CHUNK_SIZE / 1024);
				break;
			} else if (++stalls > 1000) {
				printk("stuck: nothing decodes or fits, %d frames\n", frames);
				break;
			}
		}
		if (eof && have == 0 && !flushed) {
			vdec_stream_flush(dev, stream);
			flushed = true;
		}
	}

	{
		int64_t ms = k_uptime_get() - start;

		printk("done: %d frames in %lld ms (%d.%02d fps), %d late\n", frames, ms,
		       (int)(frames * 1000LL / ms), (int)(frames * 100000LL / ms) % 100, late);
	}
	k_sleep(K_FOREVER);

	return 0;
}
```

## src/overlay.c
```c
/*
 * Copyright (c) 2026 Yuzuki Tsuru
 *
 * SPDX-License-Identifier: Apache-2.0
 */

/*
 * Statistics overlay in the style of a video site's "stats for nerds": a
 * translucent panel in the corner with the current numbers and a scrolling
 * chart for each of them. LVGL draws it on the frame buffer plane, which the
 * display engine blends over the video plane by pixel alpha.
 */

#include <lvgl.h>
#include <string.h>
#include <zephyr/kernel.h>
#include <zephyr/sys/util.h>

#include "overlay.h"

#define SAMPLE_MS	250
/* rates are taken over the last second: this many samples */
#define WINDOW		(1000 / SAMPLE_MS)
/* points per chart: 15 seconds */
#define POINTS		60
#define PANEL_W		380
#define CHART_H		46
#define STACK_SIZE	6144
#define PRIORITY	8

struct play_stats play_stats;

K_THREAD_STACK_DEFINE(stack, STACK_SIZE);
static struct k_thread thread;

/* the counters at one sample */
struct snapshot {
	uint32_t frames;
	uint32_t sd_bytes;
	uint32_t decode_us;
	int64_t at;
};

struct series {
	lv_obj_t *label;
	lv_obj_t *chart;
	lv_chart_series_t *line;
	/* chart y range: the smallest multiple of `step` above the largest value shown */
	int32_t floor;
	int32_t step;
	int32_t values[POINTS];
};

static void series_create(struct series *s, lv_obj_t *parent, lv_color_t color, int32_t floor,
			  int32_t step)
{
	s->floor = floor;
	s->step = step;

	s->label = lv_label_create(parent);
	lv_obj_set_style_text_color(s->label, lv_color_white(), 0);
	lv_obj_set_style_text_font(s->label, &lv_font_montserrat_16, 0);
	lv_label_set_text(s->label, "-");

	s->chart = lv_chart_create(parent);
	lv_obj_set_size(s->chart, PANEL_W - 24, CHART_H);
	lv_chart_set_type(s->chart, LV_CHART_TYPE_LINE);
	lv_chart_set_point_count(s->chart, POINTS);
	lv_chart_set_update_mode(s->chart, LV_CHART_UPDATE_MODE_SHIFT);
	lv_chart_set_div_line_count(s->chart, 3, 0);
	lv_obj_set_style_bg_opa(s->chart, LV_OPA_TRANSP, 0);
	lv_obj_set_style_border_width(s->chart, 1, 0);
	lv_obj_set_style_border_color(s->chart, lv_color_make(90, 90, 90), 0);
	lv_obj_set_style_pad_all(s->chart, 0, 0);
	lv_obj_set_style_line_color(s->chart, lv_color_make(70, 70, 70), LV_PART_MAIN);
	lv_obj_set_style_line_width(s->chart, 1, LV_PART_MAIN);
	/* a plain line: no marker on each point */
	lv_obj_set_style_size(s->chart, 0, 0, LV_PART_INDICATOR);
	lv_obj_set_style_line_width(s->chart, 2, LV_PART_ITEMS);

	s->line = lv_chart_add_series(s->chart, color, LV_CHART_AXIS_PRIMARY_Y);
	lv_chart_set_all_value(s->chart, s->line, LV_CHART_POINT_NONE);
	lv_chart_set_range(s->chart, LV_CHART_AXIS_PRIMARY_Y, 0, floor);
	for (int i = 0; i < POINTS; i++) {
		s->values[i] = LV_CHART_POINT_NONE;
	}
}

/* Add a point and rescale the chart to what it shows */
static void series_push(struct series *s, int32_t value)
{
	int32_t top = s->floor;

	memmove(s->values, s->values + 1, sizeof(s->values) - sizeof(s->values[0]));
	s->values[POINTS - 1] = value;
	for (int i = 0; i < POINTS; i++) {
		if (s->values[i] != LV_CHART_POINT_NONE && s->values[i] > top) {
			top = s->values[i];
		}
	}
	top = ROUND_UP(top, s->step);

	lv_chart_set_range(s->chart, LV_CHART_AXIS_PRIMARY_Y, 0, top);
	lv_chart_set_next_value(s->chart, s->line, value);
}

static void overlay_main(void *a, void *b, void *c)
{
	struct snapshot hist[WINDOW + 1];
	struct series fps, sd, dec;
	lv_obj_t *panel, *title, *info;
	int64_t next = k_uptime_get() + SAMPLE_MS;
	unsigned int n = 0;

	/* before anything was counted every slot of the history is the start */
	for (int i = 0; i < ARRAY_SIZE(hist); i++) {
		hist[i] = (struct snapshot){.at = k_uptime_get()};
	}

	/* everything outside the panel shows the video: keep the screen itself clear */
	lv_obj_set_style_bg_opa(lv_screen_active(), LV_OPA_TRANSP, 0);

	panel = lv_obj_create(lv_screen_active());
	lv_obj_remove_style_all(panel);
	lv_obj_set_size(panel, PANEL_W, LV_SIZE_CONTENT);
	lv_obj_align(panel, LV_ALIGN_TOP_LEFT, 12, 12);
	lv_obj_set_flex_flow(panel, LV_FLEX_FLOW_COLUMN);
	lv_obj_set_style_pad_all(panel, 10, 0);
	lv_obj_set_style_pad_row(panel, 3, 0);
	lv_obj_set_style_bg_color(panel, lv_color_black(), 0);
	lv_obj_set_style_bg_opa(panel, LV_OPA_60, 0);
	lv_obj_set_style_radius(panel, 8, 0);

	title = lv_label_create(panel);
	lv_obj_set_style_text_color(title, lv_color_make(255, 220, 80), 0);
	lv_obj_set_style_text_font(title, &lv_font_montserrat_16, 0);
	lv_label_set_text(title, "Stats for nerds");

	info = lv_label_create(panel);
	lv_obj_set_style_text_color(info, lv_color_white(), 0);
	lv_obj_set_style_text_font(info, &lv_font_montserrat_16, 0);
	lv_label_set_text(info, "waiting for the first frame");

	series_create(&fps, panel, lv_color_make(80, 220, 100), 4000, 1000);
	series_create(&sd, panel, lv_color_make(80, 160, 255), 100, 100);
	series_create(&dec, panel, lv_color_make(255, 150, 60), 4000, 1000);

	while (true) {
		lv_timer_handler();

		if (k_uptime_get() >= next) {
			struct snapshot now = {
				.frames = play_stats.frames,
				.sd_bytes = play_stats.sd_bytes,
				.decode_us = play_stats.decode_us,
				.at = k_uptime_get(),
			};
			/* the oldest snapshot of the last second, fewer at the start */
			const struct snapshot *old = &hist[n % (WINDOW + 1)];
			uint32_t ms = (uint32_t)(now.at - old->at);
			uint32_t frames = now.frames - old->frames;
			uint32_t sd_bytes = now.sd_bytes - old->sd_bytes;
			uint32_t us = now.decode_us - old->decode_us;

			hist[n % (WINDOW + 1)] = now;
			n++;
			next += SAMPLE_MS;

			if (play_stats.width != 0 && ms != 0) {
				/* x100: frames per second and milliseconds per frame */
				int32_t fps100 = frames * 100000U / ms;
				int32_t sd_kib = (uint64_t)sd_bytes * 1000 / ms / 1024;
				int32_t dec100 = frames ? us / 10U / frames : 0;
				/* NV12 produced by the decoder, then read again by the display */
				uint32_t out100 = (uint64_t)frames * play_stats.width *
						  play_stats.height * 3 / 2 * 1000 / ms * 100 /
						  (1024 * 1024);

				lv_label_set_text_fmt(info, "%ux%u  H.264   decoded %u.%02u MiB/s   late %u",
						      play_stats.width, play_stats.height,
						      out100 / 100, out100 % 100, play_stats.late);
				lv_label_set_text_fmt(fps.label, "Frame rate   %d.%02d fps",
						      fps100 / 100, fps100 % 100);
				lv_label_set_text_fmt(sd.label, "SD card read   %d KiB/s", sd_kib);
				lv_label_set_text_fmt(dec.label, "Decoder time   %d.%02d ms/frame",
						      dec100 / 100, dec100 % 100);
				series_push(&fps, fps100);
				series_push(&sd, sd_kib);
				series_push(&dec, dec100);
			}
		}
		k_msleep(40);
	}
}

int overlay_start(void)
{
	k_tid_t tid = k_thread_create(&thread, stack, STACK_SIZE, overlay_main, NULL, NULL, NULL,
				      PRIORITY, 0, K_NO_WAIT);

	k_thread_name_set(tid, "overlay");

	return 0;
}
```

## src/overlay.h
```c
/*
 * Copyright (c) 2026 Yuzuki Tsuru
 *
 * SPDX-License-Identifier: Apache-2.0
 */

#ifndef H264_PLAYER_OVERLAY_H_
#define H264_PLAYER_OVERLAY_H_

#include <stdint.h>

/*
 * Counters the player keeps and the overlay turns into rates once a second.
 * They only ever count up; the player and the overlay thread run apart.
 */
struct play_stats {
	/* frames put on the screen */
	volatile uint32_t frames;
	/* bytes read from the card */
	volatile uint32_t sd_bytes;
	/* time the decoder calls took, in microseconds */
	volatile uint32_t decode_us;
	/* size of the picture */
	volatile uint16_t width;
	volatile uint16_t height;
	/* frames that missed their time */
	volatile uint32_t late;
};

extern struct play_stats play_stats;

/* Start the thread that draws the statistics on top of the video */
int overlay_start(void);

#endif /* H264_PLAYER_OVERLAY_H_ */
```
