## CMakeLists.txt
```
# Copyright (c) 2026 Yuzuki Tsuru
# SPDX-License-Identifier: Apache-2.0

cmake_minimum_required(VERSION 3.20.0)
find_package(Zephyr REQUIRED HINTS $ENV{ZEPHYR_BASE})
project(cherryusb_cdc_acm)

target_sources(app PRIVATE src/main.c
	${ZEPHYR_CHERRYUSB_MODULE_DIR}/demo/cdc_acm_template.c)
```

## sample.yaml
```
sample:
  name: CherryUSB CDC ACM on the sunxi OTG controller
tests:
  sample.drivers.usb.cherryusb_cdc_acm:
    platform_allow: f101_evb
    tags: usb
    harness: none
    build_only: true
```

## prj.conf
```kconfig
CONFIG_CHERRYUSB=y
CONFIG_CHERRYUSB_DEVICE=y
CONFIG_CHERRYUSB_DEVICE_SPEED_HS=y
CONFIG_CHERRYUSB_DEVICE_MUSB_SUNXI=y
CONFIG_CHERRYUSB_DEVICE_CDC_ACM=y
CONFIG_MAIN_STACK_SIZE=4096
CONFIG_SYSTEM_WORKQUEUE_STACK_SIZE=2048
CONFIG_HEAP_MEM_POOL_SIZE=65536
CONFIG_SHELL=n
CONFIG_DEVMEM_SHELL=n
```

## src/main.c
```c
/*
 * Copyright (c) 2026 Yuzuki Tsuru
 *
 * SPDX-License-Identifier: Apache-2.0
 */

#include <zephyr/kernel.h>
#include <zephyr/sys/printk.h>

extern void cdc_acm_init(uint8_t busid, uintptr_t reg_base);
extern uintptr_t usb_sunxi_otg_base(void);
extern void cdc_acm_data_send_with_dtr_test(uint8_t busid);

int main(void)
{
	cdc_acm_init(0, usb_sunxi_otg_base());
	printk("CherryUSB CDC ACM started\n");

	/* stream the demo buffer to the host while a terminal has the port open */
	while (true) {
		cdc_acm_data_send_with_dtr_test(0);
		k_msleep(100);
	}

	return 0;
}
```
