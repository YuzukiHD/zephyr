## CMakeLists.txt
```
# Copyright (c) 2026 Yuzuki Tsuru
# SPDX-License-Identifier: Apache-2.0

cmake_minimum_required(VERSION 3.20.0)
find_package(Zephyr REQUIRED HINTS $ENV{ZEPHYR_BASE})
project(cherryusb_display)

target_sources(app PRIVATE src/main.c src/usb_touch.c)
target_sources_ifdef(CONFIG_SAMPLE_USB_DISPLAY_CTP app PRIVATE src/usb_ctp.c)
```

## Kconfig
```
# Copyright (c) 2026 Yuzuki Tsuru
# SPDX-License-Identifier: Apache-2.0

mainmenu "USB second screen"

config SAMPLE_USB_DISPLAY_WIDTH
	int "Width the host is told, 0 for the width of the panel"
	default 0

config SAMPLE_USB_DISPLAY_HEIGHT
	int "Height the host is told, 0 for the height of the panel"
	default 0

config SAMPLE_USB_DISPLAY_FPS
	int "Frame rate the host is told"
	default 60
	range 1 120

config SAMPLE_USB_DISPLAY_QUALITY
	int "JPEG quality the host is told (1..10)"
	default 9
	range 1 10

config SAMPLE_USB_DISPLAY_TOUCH
	bool "Add a HID multi-touch screen to the device"
	default y
	help
	  Makes the device a composite one: the display on interface 0 and a five finger
	  touch screen on interface 1. Windows loads its own driver for the latter.

config SAMPLE_USB_DISPLAY_TOUCH_DEMO
	bool "Send a synthetic two finger drag when the host has configured the device"
	depends on SAMPLE_USB_DISPLAY_TOUCH

config SAMPLE_USB_DISPLAY_CTP
	bool "Take the touch points from the touch panel on I2C1"
	depends on SAMPLE_USB_DISPLAY_TOUCH
	default y

config SAMPLE_USB_DISPLAY_CTP_SWAP
	bool "Exchange X and Y of the touch panel"
	depends on SAMPLE_USB_DISPLAY_CTP

config SAMPLE_USB_DISPLAY_CTP_FLIP_X
	bool "Mirror X of the touch panel"
	depends on SAMPLE_USB_DISPLAY_CTP

config SAMPLE_USB_DISPLAY_CTP_FLIP_Y
	bool "Mirror Y of the touch panel"
	depends on SAMPLE_USB_DISPLAY_CTP

source "Kconfig.zephyr"
```

## sample.yaml
```
sample:
  name: USB second screen
tests:
  sample.drivers.usb.cherryusb_display:
    platform_allow: f101_evb
    tags: usb display
    harness: none
    build_only: true
```

## prj.conf
```kconfig
CONFIG_CHERRYUSB=y
CONFIG_CHERRYUSB_DEVICE=y
CONFIG_CHERRYUSB_DEVICE_SPEED_HS=y
CONFIG_CHERRYUSB_DEVICE_MUSB_SUNXI=y
CONFIG_CHERRYUSB_DEVICE_DISPLAY=y
CONFIG_CHERRYUSB_DEVICE_HID=y

CONFIG_DISPLAY=y
CONFIG_VDEC=y
CONFIG_FPU=y
CONFIG_FPU_SHARING=y

CONFIG_MAIN_STACK_SIZE=8192
CONFIG_SYSTEM_WORKQUEUE_STACK_SIZE=2048
CONFIG_COMMON_LIBC_MALLOC_ARENA_SIZE=-1
CONFIG_HEAP_MEM_POOL_SIZE=65536
CONFIG_PRINTK=y
CONFIG_SHELL=n
CONFIG_DEVMEM_SHELL=n

# drivers the second screen does not use
CONFIG_G2D=n
CONFIG_ADC=n
CONFIG_SPI=n
CONFIG_I2C=y
CONFIG_GPIO=y
CONFIG_MIPI_DBI=n
CONFIG_WDT_SUNXI=n

# a small image: no logging (errors of the drivers are not printed), size optimised code
CONFIG_LOG=n
CONFIG_SIZE_OPTIMIZATIONS=y

# the frame buffer comes from the heap, not from the image
CONFIG_DISPLAY_SUNXI_FB_ALLOC=y
```

## boards/f101_evb.overlay
```dts
/*
 * Copyright (c) 2026 Yuzuki Tsuru
 *
 * SPDX-License-Identifier: Apache-2.0
 */

/* the touch panel controller on I2C1 */
&pio {
	twi1_ctp_pins: twi1_ctp_pins {
		twi1_ctp_group {
			pinmux = <ALLWINNER_PINMUX(ALLWINNER_PIO_PE, 0, 4)
				  ALLWINNER_PINMUX(ALLWINNER_PIO_PE, 1, 4)>;
			bias-pull-up;
		};
	};
};

&i2c1 {
	status = "okay";
	pinctrl-0 = <&twi1_ctp_pins>;
	pinctrl-names = "default";
};
```

## src/main.c
```c
/*
 * Copyright (c) 2026 Yuzuki Tsuru
 *
 * SPDX-License-Identifier: Apache-2.0
 */

/*
 * USB second screen: the board enumerates as a virtual display for the Windows "usb graphic"
 * display driver. The PC sends its desktop as JPEG frames over a bulk endpoint, the video engine
 * decodes them and the picture goes to the video plane of the display, which scales it to the
 * panel keeping its shape.
 *
 * The host is told the size, frame rate and JPEG quality through the product string (see the
 * SAMPLE_USB_DISPLAY_* options); by default the size of the panel.
 */

#include <stdlib.h>
#include <string.h>

#include <zephyr/kernel.h>
#include <zephyr/device.h>
#include <zephyr/drivers/display.h>
#include <zephyr/drivers/display/display_sunxi.h>
#include <zephyr/drivers/vdec.h>
#include <zephyr/sys/printk.h>
#include <zephyr/sys/util.h>

#include "usbd_core.h"
#include "usbd_display.h"
#include "usb_touch.h"
#ifdef CONFIG_SAMPLE_USB_DISPLAY_CTP
#include "usb_ctp.h"
#endif

extern uintptr_t usb_sunxi_otg_base(void);

#define DISPLAY_IN_EP   0x81
#define DISPLAY_OUT_EP  0x02

#define USBD_VID        0x303A
#define USBD_PID        0x2987     /* the display alone */
#define USBD_PID_TOUCH  0x2986     /* composite: display on interface 0, touch screen on 1 */
#define USBD_MAX_POWER  100
#define USB_CONFIG_SIZE (9 + 9 + 7 + 7)
#define USB_CONFIG_SIZE_TOUCH (USB_CONFIG_SIZE + USB_TOUCH_DESCRIPTOR_SIZE)

#define DISPLAY_EP_MPS  512

/*
 * A JPEG frame is at most 512 KiB; the driver reads in steps of 16 KiB, so the buffer is a
 * multiple of that and holds one step more than the largest frame.
 */
#define FRAME_BUF_SIZE  (34 * 16384)
#define FRAME_COUNT     2
#define FRAME_LIMIT_KB  500
#define REPORT_MS       5000

#define JPEG_VBV_SIZE   (1024 * 1024)

#define MIN_SIZE        64
#define MAX_WIDTH       1920
#define MAX_HEIGHT      1080

/* name, size, encoding (jpg quality 1..10), frame rate, frame limit in KB */
#define PRODUCT_FORMAT  "cherryusb_R%ux%u_Ejpg%u_Fps%u_Bl%u"

static const struct device *const vdec_dev = DEVICE_DT_GET(DT_NODELABEL(ve));
static const struct device *const disp = DEVICE_DT_GET(DT_CHOSEN(zephyr_display));

static char product_string[64];

static uint8_t device_descriptor[] = {
	USB_DEVICE_DESCRIPTOR_INIT(USB_2_0, 0x00, 0x00, 0x00, USBD_VID, USBD_PID, 0x0101, 0x01)
};

static uint8_t config_descriptor[USB_CONFIG_SIZE_TOUCH];

/* the display interface, plus the touch screen if asked for */
static void build_config_descriptor(void)
{
	static const uint8_t display_part[] = {
		USB_INTERFACE_DESCRIPTOR_INIT(0x00, 0x00, 0x02, 0xff, 0x00, 0x00, 0x00),
		USB_ENDPOINT_DESCRIPTOR_INIT(DISPLAY_IN_EP, 0x02, DISPLAY_EP_MPS, 0x00),
		USB_ENDPOINT_DESCRIPTOR_INIT(DISPLAY_OUT_EP, 0x02, DISPLAY_EP_MPS, 0x00),
	};
	const uint8_t head[9] = {
		USB_CONFIG_DESCRIPTOR_INIT(0, 0x01, 0x01, USB_CONFIG_BUS_POWERED, USBD_MAX_POWER)
	};
	uint32_t len = sizeof(head);

	memcpy(config_descriptor, head, sizeof(head));
	memcpy(config_descriptor + len, display_part, sizeof(display_part));
	len += sizeof(display_part);
	if (IS_ENABLED(CONFIG_SAMPLE_USB_DISPLAY_TOUCH)) {
		len += usb_touch_descriptor(config_descriptor + len, USB_TOUCH_INTERFACE);
		config_descriptor[4] = 2;			/* bNumInterfaces */
		device_descriptor[10] = USBD_PID_TOUCH & 0xFF;	/* idProduct */
		device_descriptor[11] = USBD_PID_TOUCH >> 8;
	}
	config_descriptor[2] = len & 0xFF;			/* wTotalLength */
	config_descriptor[3] = len >> 8;
}

static const uint8_t device_quality_descriptor[] = {
	0x0a, USB_DESCRIPTOR_TYPE_DEVICE_QUALIFIER, 0x00, 0x02, 0x00, 0x00, 0x00, 0x40, 0x00, 0x00,
};

static const char *string_descriptors[] = {
	(const char[]){0x09, 0x04}, /* language id */
	"CherryUSB",                /* manufacturer */
	product_string,             /* product */
	"2022123456",               /* serial number */
};

static const uint8_t *device_descriptor_callback(uint8_t speed)
{
	return device_descriptor;
}

static const uint8_t *config_descriptor_callback(uint8_t speed)
{
	return config_descriptor;
}

static const uint8_t *device_quality_descriptor_callback(uint8_t speed)
{
	return device_quality_descriptor;
}

static const char *string_descriptor_callback(uint8_t speed, uint8_t index)
{
	if (index >= ARRAY_SIZE(string_descriptors)) {
		return NULL;
	}

	return string_descriptors[index];
}

static const struct usb_descriptor display_descriptor = {
	.device_descriptor_callback = device_descriptor_callback,
	.config_descriptor_callback = config_descriptor_callback,
	.device_quality_descriptor_callback = device_quality_descriptor_callback,
	.string_descriptor_callback = string_descriptor_callback,
};

static K_SEM_DEFINE(configured, 0, 1);

static void usbd_event_handler(uint8_t busid, uint8_t event)
{
	switch (event) {
	case USBD_EVENT_CONFIGURED:
		printk("usb display: configured by the host\n");
		k_sem_give(&configured);
		break;
	case USBD_EVENT_DISCONNECTED:
		printk("usb display: disconnected\n");
		break;
	default:
		break;
	}
}

#ifdef CONFIG_SAMPLE_USB_DISPLAY_TOUCH_DEMO
/* a short drag with two fingers once the host has configured the device */
static void demo_fn(struct k_work *work)
{
	usb_touch_demo(2);
}
static K_WORK_DELAYABLE_DEFINE(demo_work, demo_fn);
#endif

static struct usbd_interface display_intf;
static struct usbd_display_frame frame_pool[FRAME_COUNT];

/*
 * A decoder that stays open while the picture size stays the same: motion JPEG through the stream
 * API. The decoded pictures go to the display as they are; the one before the last may still be
 * scanned out, so it is released one frame late.
 */
static struct vdec_stream *jpeg_stream;
static uint32_t jpeg_w, jpeg_h;
/* pictures the decoder keeps for us (1..3), the most the memory allows */
static int jpeg_hold = 3;
static struct vdec_frame shown, older;

static uint32_t frames_ok, frames_bad, bytes_in, decode_us, show_us;

static void stream_close(void)
{
	if (older.priv) {
		vdec_frame_release(vdec_dev, &older);
		older.priv = NULL;
	}
	if (shown.priv) {
		vdec_frame_release(vdec_dev, &shown);
		shown.priv = NULL;
	}
	if (jpeg_stream) {
		vdec_stream_close(vdec_dev, jpeg_stream);
	}
	jpeg_stream = NULL;
}

static int stream_open(uint32_t w, uint32_t h)
{
	int ret = -ENOMEM;

	/* one held picture (a show that waits for the refresh) is the least that works */
	for (jpeg_hold = 3; jpeg_hold >= 1; jpeg_hold--) {
		struct vdec_stream_config cfg = {
			.codec = VDEC_CODEC_JPEG,
			.format = VDEC_FORMAT_NV12,
			.buffer_size = JPEG_VBV_SIZE,
			.no_cache_ops = true,
			.holding_frames = jpeg_hold,
			.width = w,
			.height = h,
		};

		ret = vdec_stream_open(vdec_dev, &cfg, &jpeg_stream);
		if (ret == 0) {
			jpeg_w = w;
			jpeg_h = h;
			printk("usb display: %ux%u decoder, %d pictures kept (%s show)\n", w, h,
			       jpeg_hold, jpeg_hold >= 2 ? "no-wait" : "waiting");
			return 0;
		}
	}

	return ret;
}

/* decode one JPEG of w x h pixels and put it on the screen; 0 on success */
static int show_jpeg(const void *jpeg, size_t len, uint32_t w, uint32_t h)
{
	struct vdec_frame f;
	struct display_sunxi_yuv yuv;
	size_t used;
	uint32_t t0 = k_cycle_get_32();
	int ret, tries;

	if (jpeg_stream && (w != jpeg_w || h != jpeg_h)) {
		stream_close();
	}
	if (!jpeg_stream) {
		ret = stream_open(w, h);
		if (ret) {
			return ret;
		}
	}
	ret = vdec_stream_feed(vdec_dev, jpeg_stream, jpeg, len, 0, &used);
	if (ret) {
		return ret;
	}
	for (tries = 0; tries < 20; tries++) {
		ret = vdec_stream_get_frame(vdec_dev, jpeg_stream, &f);
		if (ret != -EBUSY && ret != -EAGAIN) {
			break;
		}
		k_msleep(1);
	}
	if (ret) {
		return ret;
	}
	decode_us += k_cyc_to_us_floor32(k_cycle_get_32() - t0);

	t0 = k_cycle_get_32();
	memset(&yuv, 0, sizeof(yuv));
	yuv.y = f.plane[0];
	yuv.uv = f.plane[1];
	yuv.width = f.width;
	yuv.height = f.height;
	yuv.stride_y = f.stride[0];
	yuv.stride_uv = f.stride[1];
	yuv.full_range = true;
	/*
	 * With room for two kept pictures the show does not wait for the refresh and the picture
	 * before the last is freed one step late (it may still be scanned out). With one kept
	 * picture the show waits, then the picture before is free.
	 */
	yuv.nonblock = jpeg_hold >= 2;
	ret = display_sunxi_show_yuv(disp, &yuv);
	show_us += k_cyc_to_us_floor32(k_cycle_get_32() - t0);
	if (jpeg_hold >= 2) {
		if (older.priv) {
			vdec_frame_release(vdec_dev, &older);
		}
		older = shown;
	} else if (shown.priv) {
		vdec_frame_release(vdec_dev, &shown);
	}
	shown = f;

	return ret;
}

/* a whole JPEG: SOI first, EOI last (zero padding may follow it) */
static bool jpeg_complete(const uint8_t *d, uint32_t n)
{
	uint32_t e = n;

	while (e > 2 && d[e - 1] == 0) {
		e--;
	}

	return n >= 4 && d[0] == 0xff && d[1] == 0xd8 && d[e - 2] == 0xff && d[e - 1] == 0xd9;
}

static void handle_frame(struct usbd_display_frame *frame)
{
	struct usbd_disp_frame_header *h = (struct usbd_disp_frame_header *)frame->frame_buf;
	const uint8_t *d = frame->frame_buf + sizeof(*h);
	uint32_t n = frame->frame_size;

	/* a frame that fills the last packet exactly is followed by an empty frame of type 0xff */
	if (frame->frame_format != USBD_DISPLAY_TYPE_JPG || n == 0) {
		return;
	}
	bytes_in += n;
	if (!jpeg_complete(d, n)) {
		if (++frames_bad <= 12) {
			printk("usb display: broken frame %u: size %u\n", h->frame_id, n);
		}
		return;
	}

	int err = show_jpeg(d, n, h->width, h->height);

	if (err == 0) {
		frames_ok++;
	} else if (++frames_bad <= 8) {
		printk("usb display: frame %u (%ux%u, %u bytes) failed: %d\n", h->frame_id, h->width,
		       h->height, n, err);
	}
}

int main(void)
{
	struct display_capabilities caps;
	uint32_t w = CONFIG_SAMPLE_USB_DISPLAY_WIDTH, h = CONFIG_SAMPLE_USB_DISPLAY_HEIGHT;
	uint32_t last, start_ok = 0, start_bytes = 0;

	if (!device_is_ready(disp) || !device_is_ready(vdec_dev)) {
		printk("usb display: display or video engine not ready\n");
		return -ENODEV;
	}
	display_get_capabilities(disp, &caps);
	if (!w || !h) {
		w = caps.x_resolution;
		h = caps.y_resolution;
	}
	if (w < MIN_SIZE || h < MIN_SIZE || w > MAX_WIDTH || h > MAX_HEIGHT || (w & 1) || (h & 1)) {
		printk("usb display: %ux%u not possible (size %d..%d x %d..%d, even)\n", w, h,
		       MIN_SIZE, MAX_WIDTH, MIN_SIZE, MAX_HEIGHT);
		return -EINVAL;
	}

	snprintk(product_string, sizeof(product_string), PRODUCT_FORMAT, w, h,
		 CONFIG_SAMPLE_USB_DISPLAY_QUALITY, CONFIG_SAMPLE_USB_DISPLAY_FPS, FRAME_LIMIT_KB);
	for (int i = 0; i < FRAME_COUNT; i++) {
		frame_pool[i].frame_buf = aligned_alloc(64, FRAME_BUF_SIZE);
		frame_pool[i].frame_bufsize = FRAME_BUF_SIZE;
		if (!frame_pool[i].frame_buf) {
			printk("usb display: no memory for the frame buffers\n");
			return -ENOMEM;
		}
	}

	build_config_descriptor();
	usbd_desc_register(0, &display_descriptor);
	usbd_add_interface(0, usbd_display_init_intf(&display_intf, DISPLAY_OUT_EP, DISPLAY_IN_EP,
						    frame_pool, FRAME_COUNT));
	if (IS_ENABLED(CONFIG_SAMPLE_USB_DISPLAY_TOUCH)) {
		usb_touch_init(0);
#ifdef CONFIG_SAMPLE_USB_DISPLAY_CTP
		usb_ctp_start();
#endif
	}
	usbd_initialize(0, usb_sunxi_otg_base(), usbd_event_handler);
	printk("usb display: waiting for the host (%s), shown on the %ux%u panel\n", product_string,
	       caps.x_resolution, caps.y_resolution);

	last = k_uptime_get_32();
	for (;;) {
#ifdef CONFIG_SAMPLE_USB_DISPLAY_TOUCH_DEMO
		if (k_sem_take(&configured, K_NO_WAIT) == 0) {
			k_work_schedule(&demo_work, K_SECONDS(3));
		}
#endif
		struct usbd_display_frame *frame;

		if (usbd_display_dequeue(&frame, 1000) >= 0) {
			handle_frame(frame);
			usbd_display_enqueue(frame);
		}

		uint32_t ms = k_uptime_get_32() - last;

		if (ms >= REPORT_MS) {
			uint32_t n = frames_ok - start_ok;

			printk("usb display: %u frames (%u.%02u fps), %u KB/s, %u bad, decode %u us, "
			       "show %u us per frame\n", n, n * 1000 / ms,
			       (n * 100000 / ms) % 100, (bytes_in - start_bytes) / ms, frames_bad,
			       n ? decode_us / n : 0, n ? show_us / n : 0);
			decode_us = show_us = 0;
			start_ok = frames_ok;
			start_bytes = bytes_in;
			last = k_uptime_get_32();
		}
	}

	return 0;
}
```

## src/usb_ctp.c
```c
/*
 * Copyright (c) 2026 Yuzuki Tsuru
 *
 * SPDX-License-Identifier: Apache-2.0
 */

/*
 * The capacitive touch panel (FT5x46 family, I2C address 0x38 on I2C1) as the touch screen of the
 * USB display: a thread polls the controller and turns its points into reports of the HID touch
 * interface.
 */

#include <string.h>

#include <zephyr/kernel.h>
#include <zephyr/device.h>
#include <zephyr/drivers/gpio.h>
#include <zephyr/drivers/i2c.h>
#include <zephyr/sys/printk.h>

#include "usb_ctp.h"
#include "usb_touch.h"

#define CTP_ADDR	0x38
#define CTP_MAX_X	1024
#define CTP_MAX_Y	600
#define CTP_POLL_MS	10

#define REG_TD_STATUS	0x02
#define POINT_BYTES	6
#define POINTS		USB_TOUCH_MAX_CONTACTS

static const struct device *const bus = DEVICE_DT_GET(DT_NODELABEL(i2c1));
static const struct device *const pe = DEVICE_DT_GET(DT_NODELABEL(gpioe));

/* PE0 is SCL, PE1 is SDA */
static bool swap_xy = IS_ENABLED(CONFIG_SAMPLE_USB_DISPLAY_CTP_SWAP);
static bool flip_x = IS_ENABLED(CONFIG_SAMPLE_USB_DISPLAY_CTP_FLIP_X);
static bool flip_y = IS_ENABLED(CONFIG_SAMPLE_USB_DISPLAY_CTP_FLIP_Y);

/* the status register and the points behind it: [0] count, then 6 bytes per point */
static int ctp_points(uint8_t *raw)
{
	uint8_t reg = REG_TD_STATUS;

	return i2c_write_read(bus, CTP_ADDR, &reg, 1, raw, 1 + POINTS * POINT_BYTES);
}

/* log the devices that answer on the touch panel bus and, if none, the levels of its lines */
static void usb_ctp_check(void)
{
	int found = 0, scl, sda;

	if (!device_is_ready(bus)) {
		printk("usb ctp: the I2C1 bus is not ready\n");
		return;
	}
	for (uint8_t addr = 0x08; addr < 0x78; addr++) {
		uint8_t b;

		if (i2c_read(bus, &b, 1, addr) == 0) {
			printk("usb ctp: device at 0x%02x\n", addr);
			found++;
		}
	}
	printk("usb ctp: %d device(s) on I2C1\n", found);
	if (found == 0 && device_is_ready(pe)) {
		/* the line levels without the controller: a line held low by the wiring shows here */
		gpio_pin_configure(pe, 0, GPIO_INPUT);
		gpio_pin_configure(pe, 1, GPIO_INPUT);
		scl = gpio_pin_get_raw(pe, 0);
		sda = gpio_pin_get_raw(pe, 1);
		printk("usb ctp: PE0 (SCL) = %d, PE1 (SDA) = %d as GPIO inputs\n", scl, sda);
	}
}

static void scale(uint32_t x, uint32_t y, uint16_t *ox, uint16_t *oy)
{
	if (swap_xy) {
		uint32_t t = x;

		x = y;
		y = t;
	}
	if (flip_x) {
		x = CTP_MAX_X - 1 - x;
	}
	if (flip_y) {
		y = CTP_MAX_Y - 1 - y;
	}
	x = MIN(x, CTP_MAX_X - 1);
	y = MIN(y, CTP_MAX_Y - 1);
	*ox = x * USB_TOUCH_MAX / (CTP_MAX_X - 1);
	*oy = y * USB_TOUCH_MAX / (CTP_MAX_Y - 1);
}

static void ctp_thread(void *a, void *b, void *c)
{
	struct usb_touch_point out[POINTS], last[POINTS];
	bool was_down[POINTS] = {false};
	uint8_t raw[1 + POINTS * POINT_BYTES];

	/* a bus that does not answer makes every address wait for its time-out: not before the USB device is up */
	k_sleep(K_SECONDS(2));
	usb_ctp_check();
	memset(last, 0, sizeof(last));
	for (;;) {
		bool down[POINTS] = {false};
		int n, count = 0;
		bool changed = false;

		k_msleep(CTP_POLL_MS);
		if (ctp_points(raw) != 0) {
			continue;
		}
		n = raw[0] & 0x0F;
		if (n > POINTS) {
			n = 0;
		}
		memset(out, 0, sizeof(out));
		for (int i = 0; i < n; i++) {
			const uint8_t *p = &raw[1 + i * POINT_BYTES];
			int id = p[2] >> 4;
			uint32_t x = ((p[0] & 0x0F) << 8) | p[1];
			uint32_t y = ((p[2] & 0x0F) << 8) | p[3];

			if (id >= POINTS || (p[0] >> 6) == 1) { /* lifted */
				continue;
			}
			down[id] = true;
			out[id].id = id;
			out[id].down = true;
			scale(x, y, &out[id].x, &out[id].y);
		}
		for (int i = 0; i < POINTS; i++) {
			if (!down[i] && was_down[i]) {
				/* one report with the tip switch off */
				out[i] = last[i];
				out[i].down = false;
				changed = true;
			}
			if (down[i] && (!was_down[i] || out[i].x != last[i].x ||
					out[i].y != last[i].y)) {
				changed = true;
			}
			if (down[i] || was_down[i]) {
				count = i + 1;
			}
		}
		if (!changed) {
			continue;
		}
		/* the report holds the slots 0..count-1; free slots are sent as not touching */
		for (int i = 0; i < count; i++) {
			if (!down[i] && !was_down[i]) {
				memset(&out[i], 0, sizeof(out[i]));
				out[i].id = i;
			}
		}
		while (usb_touch_send(out, count) == -EBUSY) {
			k_msleep(1);
		}
		for (int i = 0; i < POINTS; i++) {
			was_down[i] = down[i];
			if (down[i]) {
				last[i] = out[i];
			}
		}
	}
}

K_THREAD_STACK_DEFINE(ctp_stack, 2048);
static struct k_thread ctp_thread_data;

void usb_ctp_start(void)
{
	if (!device_is_ready(bus)) {
		return;
	}
	k_thread_create(&ctp_thread_data, ctp_stack, K_THREAD_STACK_SIZEOF(ctp_stack), ctp_thread,
			NULL, NULL, NULL, 9, 0, K_NO_WAIT);
	k_thread_name_set(&ctp_thread_data, "ctp");
}
```

## src/usb_ctp.h
```c
/*
 * Copyright (c) 2026 Yuzuki Tsuru
 *
 * SPDX-License-Identifier: Apache-2.0
 */

#ifndef USB_CTP_H_
#define USB_CTP_H_

/* start the thread that reads the touch panel and sends its points to the USB touch screen */
void usb_ctp_start(void);

#endif
```

## src/usb_touch.c
```c
/*
 * Copyright (c) 2026 Yuzuki Tsuru
 *
 * SPDX-License-Identifier: Apache-2.0
 */

/* The HID touch screen of the USB display: report descriptor, reports and a synthetic demo. */

#include <errno.h>
#include <string.h>

#include <zephyr/kernel.h>
#include <zephyr/sys/printk.h>

#include "usbd_core.h"
#include "usbd_hid.h"
#include "usb_touch.h"

#define REPORT_ID               1
#define FEATURE_REPORT          3
#define CONTACT_BYTES           6       /* tip switch, id, x (2), y (2) */
#define REPORT_SIZE             (1 + USB_TOUCH_MAX_CONTACTS * CONTACT_BYTES + 1)

/* the panel size in 0.01 cm units: 154 x 86 mm */
#define PHYS_X                  1540
#define PHYS_Y                  860

/* one finger: tip switch, padding, contact id, X, Y */
#define FINGER_ITEMS                                                                                           \
	0x09, 0x22,                 /* Usage (Finger) */                                                           \
	0xA1, 0x02,                 /* Collection (Logical) */                                                     \
	0x09, 0x42,                 /*   Usage (Tip Switch) */                                                     \
	0x15, 0x00, 0x25, 0x01,     /*   Logical 0..1 */                                                           \
	0x75, 0x01, 0x95, 0x01,     /*   1 bit */                                                                  \
	0x81, 0x02,                 /*   Input (Data,Var,Abs) */                                                   \
	0x75, 0x07, 0x95, 0x01,     /*   7 bits of padding */                                                      \
	0x81, 0x03,                 /*   Input (Const,Var,Abs) */                                                  \
	0x09, 0x51,                 /*   Usage (Contact Identifier) */                                             \
	0x75, 0x08, 0x95, 0x01,                                                                                    \
	0x15, 0x00, 0x25, 0x7F,                                                                                    \
	0x81, 0x02,                                                                                                \
	0x05, 0x01,                 /*   Usage Page (Generic Desktop) */                                           \
	0x09, 0x30,                 /*   Usage (X) */                                                              \
	0x15, 0x00, 0x26, 0xFF, 0x7F,                                                                              \
	0x35, 0x00, 0x46, PHYS_X & 0xFF, PHYS_X >> 8,                                                              \
	0x75, 0x10, 0x95, 0x01,                                                                                    \
	0x81, 0x02,                                                                                                \
	0x09, 0x31,                 /*   Usage (Y) */                                                              \
	0x46, PHYS_Y & 0xFF, PHYS_Y >> 8,                                                                          \
	0x81, 0x02,                                                                                                \
	0x05, 0x0D,                 /*   Usage Page (Digitizer) */                                                 \
	0xC0                        /* End Collection */

static const uint8_t report_descriptor[] = {
	0x05, 0x0D,                 /* Usage Page (Digitizer) */
	0x09, 0x04,                 /* Usage (Touch Screen) */
	0xA1, 0x01,                 /* Collection (Application) */
	0x85, REPORT_ID,            /*   Report ID */
	0x65, 0x11,                 /*   Unit (centimetre) */
	0x55, 0x0E,                 /*   Unit Exponent (-2) */
	FINGER_ITEMS, FINGER_ITEMS, FINGER_ITEMS, FINGER_ITEMS, FINGER_ITEMS,
	0x05, 0x0D,
	0x09, 0x54,                 /*   Usage (Contact Count) */
	0x75, 0x08, 0x95, 0x01,
	0x15, 0x00, 0x25, 0x7F,
	0x81, 0x02,
	0x09, 0x55,                 /*   Usage (Contact Count Maximum) */
	0x25, USB_TOUCH_MAX_CONTACTS,
	0xB1, 0x02,                 /*   Feature (Data,Var,Abs) */
	0xC0                        /* End Collection */
};

/* HID interface, HID class descriptor, interrupt IN endpoint */
uint32_t usb_touch_descriptor(uint8_t *buf, uint8_t interface)
{
	const uint8_t d[USB_TOUCH_DESCRIPTOR_SIZE] = {
		0x09, USB_DESCRIPTOR_TYPE_INTERFACE, interface, 0x00, 0x01, 0x03, 0x00, 0x00, 0x00,
		0x09, 0x21, 0x11, 0x01, 0x00, 0x01, 0x22, sizeof(report_descriptor) & 0xFF, sizeof(report_descriptor) >> 8,
		0x07, USB_DESCRIPTOR_TYPE_ENDPOINT, USB_TOUCH_EP, 0x03, USB_TOUCH_EP_MPS & 0xFF, USB_TOUCH_EP_MPS >> 8,
#ifdef CONFIG_USB_HS
		0x04,                   /* 1 ms */
#else
		0x01,
#endif
	};

	memcpy(buf, d, sizeof(d));

	return sizeof(d);
}

static struct usbd_interface hid_intf;
static uint8_t report[REPORT_SIZE] __attribute__((aligned(64)));
static volatile bool tx_busy;

static void touch_in(uint8_t busid, uint8_t ep, uint32_t nbytes)
{
	tx_busy = false;
}

static struct usbd_endpoint touch_ep = {
	.ep_addr = USB_TOUCH_EP,
	.ep_cb = touch_in
};

/* Windows asks how many fingers the screen reports (the feature report of the descriptor) */
void usbd_hid_get_report(uint8_t busid, uint8_t intf, uint8_t report_id, uint8_t report_type, uint8_t **data, uint32_t *len)
{
	static uint8_t feature[2];

	if (report_type == FEATURE_REPORT)
	{
		feature[0] = REPORT_ID;
		feature[1] = USB_TOUCH_MAX_CONTACTS;
		*data = feature;
		*len = sizeof(feature);
	}
	else
	{
		*data = report;
		*len = REPORT_SIZE;
	}
}

void usb_touch_init(uint8_t busid)
{
	usbd_add_interface(busid, usbd_hid_init_intf(busid, &hid_intf, report_descriptor, sizeof(report_descriptor)));
	usbd_add_endpoint(busid, &touch_ep);
}

int usb_touch_send(const struct usb_touch_point *points, int count)
{
	int i, active = 0;

	if (count > USB_TOUCH_MAX_CONTACTS)
		count = USB_TOUCH_MAX_CONTACTS;
	if (tx_busy)
		return -EBUSY;
	memset(report, 0, sizeof(report));
	report[0] = REPORT_ID;
	for (i = 0; i < count; i++)
	{
		uint8_t *c = &report[1 + i * CONTACT_BYTES];

		c[0] = points[i].down ? 1 : 0;
		c[1] = points[i].id;
		c[2] = points[i].x & 0xFF;
		c[3] = points[i].x >> 8;
		c[4] = points[i].y & 0xFF;
		c[5] = points[i].y >> 8;
		active++;
	}
	report[REPORT_SIZE - 1] = active;
	tx_busy = true;
	if (usbd_ep_start_write(0, USB_TOUCH_EP, report, REPORT_SIZE) != 0)
	{
		tx_busy = false;
		return -EIO;
	}

	return 0;
}

/* wait for the last report to leave */
static void wait_sent(void)
{
	int n = 100;

	while (tx_busy && n--) {
		k_msleep(1);
	}
}

void usb_touch_demo(int fingers)
{
	struct usb_touch_point p[2];
	int n = fingers > 1 ? 2 : 1, steps = 100;

	memset(p, 0, sizeof(p));
	for (int step = 0; step <= steps; step++) {
		for (int i = 0; i < n; i++) {
			p[i].id = i;
			p[i].down = true;
			p[i].x = (USB_TOUCH_MAX / 10) + (USB_TOUCH_MAX * 8 / 10) * step / steps;
			p[i].y = p[i].x;
			if (i == 1) {
				p[i].x = USB_TOUCH_MAX - p[i].x;
			}
		}
		while (usb_touch_send(p, n) == -EBUSY) {
			k_msleep(1);
		}
		k_msleep(20);
	}
	for (int i = 0; i < 2; i++) {
		p[i].down = false;
	}
	while (usb_touch_send(p, n) == -EBUSY) {
		k_msleep(1);
	}
	wait_sent();
	printk("usb touch: demo done (%d finger%s)\n", n, n > 1 ? "s" : "");
}
```
