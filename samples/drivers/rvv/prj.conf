## CMakeLists.txt
```
# SPDX-License-Identifier: Apache-2.0

cmake_minimum_required(VERSION 3.20.0)
find_package(Zephyr REQUIRED HINTS $ENV{ZEPHYR_BASE})
project(rvv)

target_sources(app PRIVATE src/main.c src/rvv_kernels.c)
```

## sample.yaml
```
sample:
  name: RISC-V vector extension
tests:
  sample.drivers.rvv:
    platform_allow:
      - f101_evb
    harness: console
    harness_config:
      type: one_line
      regex:
        - "RVV: all checks passed"
```

## prj.conf
```kconfig
CONFIG_SUN252I_F101_RVV=y
CONFIG_FPU=y
CONFIG_FPU_SHARING=y
CONFIG_ASSERT=y
CONFIG_PRINTK=y
CONFIG_TIMESLICING=y
CONFIG_TIMESLICE_SIZE=1
CONFIG_TIMESLICE_PRIORITY=0
```

## src/main.c
```c
/*
 * Copyright (c) 2026 Yuzuki Tsuru
 *
 * SPDX-License-Identifier: Apache-2.0
 */

#include <zephyr/kernel.h>
#include <zephyr/sys/printk.h>
#include <stdint.h>

extern size_t rvv_vlenb(void);
extern void rvv_add_u32(uint32_t *c, const uint32_t *a, const uint32_t *b, size_t n);
extern void rvv_set_v8(uint32_t seed);
extern uint32_t rvv_check_v8(uint32_t seed);
extern uint32_t rvv_hold_v8(uint32_t seed, uint32_t iters);

#define N 100
#define ROUNDS 200
#define HOLD_ITERS 300000

static uint32_t fail;
static struct k_timer tick;
static volatile uint32_t ticks;

static void tick_fn(struct k_timer *t)
{
	/* the interrupt handler trashes v8 and the vector CSRs too */
	rvv_set_v8(0xdeadbeef);
	ticks++;
}

static void worker(void *p1, void *p2, void *p3)
{
	uint32_t seed = (uint32_t)(uintptr_t)p1;
	volatile double f = seed;

	for (int i = 0; i < ROUNDS; i++) {
		uint32_t s = seed + i;

		f = f * 1.0001 + 1.0;	/* FPU sharing next to it */
		uint32_t got = rvv_hold_v8(s, HOLD_ITERS);

		if (got != s) {
			printk("RVV: worker %x round %d: v8 %08x != %08x\n",
			       seed, i, got, s);
			fail++;
			break;
		}
	}
}

K_THREAD_STACK_DEFINE(stack_a, 2048);
K_THREAD_STACK_DEFINE(stack_b, 2048);
static struct k_thread thr_a, thr_b;

int main(void)
{
	static uint32_t a[N], b[N], c[N];
	/* vlenb in bytes = number of e8m1 elements */
	size_t vlenb = rvv_vlenb();
	printk("RVV: VLENB = %u ((CONFIG_SUN252I_F101_VLEN / 8) = %d)\n", (unsigned)vlenb,
	       (CONFIG_SUN252I_F101_VLEN / 8));
	if (vlenb != (CONFIG_SUN252I_F101_VLEN / 8)) {
		fail++;
	}

	for (int i = 0; i < N; i++) {
		a[i] = i * 3;
		b[i] = 1000 - i;
	}
	rvv_add_u32(c, a, b, N);
	for (int i = 0; i < N; i++) {
		if (c[i] != a[i] + b[i]) {
			printk("RVV: add[%d] = %u, expected %u\n", i, c[i], a[i] + b[i]);
			fail++;
			break;
		}
	}
	printk("RVV: vector add %s\n", fail ? "FAILED" : "ok");

	k_timer_init(&tick, tick_fn, NULL);
	k_timer_start(&tick, K_USEC(300), K_USEC(300));

	k_thread_create(&thr_a, stack_a, 2048, worker, (void *)0x11110000, NULL, NULL,
			5, 0, K_NO_WAIT);
	k_thread_create(&thr_b, stack_b, 2048, worker, (void *)0x22220000, NULL, NULL,
			5, 0, K_NO_WAIT);
	/* the main thread takes part in the time slicing */
	k_thread_priority_set(k_current_get(), 5);
	for (int i = 0; i < ROUNDS; i++) {
		uint32_t s = 0x33330000 + i;

		if (rvv_hold_v8(s, HOLD_ITERS) != s) {
			printk("RVV: main round %d lost v8\n", i);
			fail++;
			break;
		}
	}
	k_thread_join(&thr_a, K_FOREVER);
	k_thread_join(&thr_b, K_FOREVER);
	k_timer_stop(&tick);

	printk("RVV: %u timer ticks during the test\n", ticks);
	if (fail) {
		printk("RVV: %u check(s) FAILED\n", fail);
	} else {
		printk("RVV: all checks passed\n");
	}
	return 0;
}
```

## src/rvv_kernels.c
```c
/*
 * Copyright (c) 2026 Yuzuki Tsuru
 *
 * SPDX-License-Identifier: Apache-2.0
 */

#include <riscv_vector.h>
#include <stdint.h>
#include <stddef.h>
#include <zephyr/sys/util.h>

size_t rvv_vlenb(void)
{
	return __riscv_vsetvlmax_e8m1();
}

/* c[i] = a[i] + b[i] */
void rvv_add_u32(uint32_t *c32, const uint32_t *a32, const uint32_t *b32, size_t n)
{
	/* the intrinsics of this toolchain take unsigned long (32 bit here) */
	unsigned long *c = (unsigned long *)c32;
	const unsigned long *a = (const unsigned long *)a32;
	const unsigned long *b = (const unsigned long *)b32;

	while (n > 0) {
		size_t vl = __riscv_vsetvl_e32m8(n);
		vuint32m8_t va = __riscv_vle32_v_u32m8(a, vl);
		vuint32m8_t vb = __riscv_vle32_v_u32m8(b, vl);

		__riscv_vse32_v_u32m8(c, __riscv_vadd_vv_u32m8(va, vb, vl), vl);
		a += vl;
		b += vl;
		c += vl;
		n -= vl;
	}
}

/*
 * Fill v8 with a pattern and read it back later. vsetvli and the vector
 * instruction are in the same asm statement so the compiler cannot move or
 * drop the vtype setup (vill is set in a thread that never used vectors).
 */
void rvv_set_v8(uint32_t seed)
{
	__asm__ volatile("vsetvli t0, zero, e32, m1, ta, ma\n\t"
			 "vmv.v.x v8, %0"
			 :: "r"(seed) : "t0", "memory");
}

/* returns seed if all elements match, else the first wrong element */
uint32_t rvv_check_v8(uint32_t seed)
{
	uint32_t out[(CONFIG_SUN252I_F101_VLEN / 8) / 4];

	__asm__ volatile("vsetvli t0, zero, e32, m1, ta, ma\n\t"
			 "vse32.v v8, (%0)"
			 :: "r"(out) : "t0", "memory");
	for (size_t i = 0; i < ARRAY_SIZE(out); i++) {
		if (out[i] != seed) {
			return out[i];
		}
	}
	return seed;
}

/*
 * Keep a pattern in v8 over a loop without any function call, so only a
 * preemption (interrupt, time slice) can disturb it. Vector registers are
 * caller saved, a call or a voluntary switch (k_sleep, k_yield) may clobber
 * them. Returns seed if v8 survived, else the first wrong element.
 */
__attribute__((optimize("no-tree-vectorize")))
uint32_t rvv_hold_v8(uint32_t seed, uint32_t iters)
{
	uint32_t out[CONFIG_SUN252I_F101_VLEN / 32];

	__asm__ volatile("vsetvli t0, zero, e32, m1, ta, ma\n\t"
			 "vmv.v.x v8, %0"
			 :: "r"(seed) : "t0", "memory");
	for (volatile uint32_t i = 0; i < iters; i++) {
	}
	__asm__ volatile("vsetvli t0, zero, e32, m1, ta, ma\n\t"
			 "vse32.v v8, (%0)"
			 :: "r"(out) : "t0", "memory");
	for (size_t i = 0; i < ARRAY_SIZE(out); i++) {
		if (out[i] != seed) {
			return out[i];
		}
	}
	return seed;
}
```
