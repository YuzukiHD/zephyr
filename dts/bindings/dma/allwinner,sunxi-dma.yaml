## dts/bindings/dma/allwinner,sunxi-dma.yaml
```yaml
# Copyright (c) 2026 Yuzuki Tsuru
# SPDX-License-Identifier: Apache-2.0

description: Allwinner sunxi legacy LLI DMA controller

compatible: "allwinner,sunxi-dma"

include: dma-controller.yaml

properties:
  reg:
    required: true

  clocks:
    type: phandle-array
    required: true

  clock-names:
    type: string-array
    required: true

  resets:
    type: phandle-array
    required: true

  dma-channels:
    type: int
    required: true

  dma-requests:
    type: int
    required: true

  "#dma-cells":
    const: 1

dma-cells:
  - channel
```

## dts/bindings/flash_controller/allwinner,sunxi-spif.yaml
```yaml
# Copyright (c) 2026 Yuzuki Tsuru
# SPDX-License-Identifier: Apache-2.0

description: |
  Allwinner sunxi SPIF, a SPI NOR flash controller with descriptor DMA,
  1/2/4 wire transfers and a memory window (XIP) through which the flash
  contents can be read and executed in place.

  The node is the flash device itself: it exposes the flash API and its
  fixed-partitions child describes the layout. Sample point tuning
  results are stored in the partition named by 'params-partition'.

compatible: "allwinner,sunxi-spif"

include: [flash-controller.yaml, pinctrl-device.yaml]

properties:
  reg:
    required: true

  reg-names:
    required: true
    description: '"ctrl" is the register block, "xip" the memory window'

  clocks:
    required: true

  clock-names:
    required: true

  resets:
    type: phandle-array
    required: true

  clock-reg:
    type: int
    required: true
    description: offset of the module clock register in the CCU

  clock-frequency:
    type: int
    required: true
    description: |
      SCK frequency in Hz of the normal (tuned) operation. The device is
      identified at a low frequency first.

  size:
    type: int
    description: |
      Flash capacity in bits. When absent the capacity is taken from the
      JEDEC ID (density byte, 2^n bytes).

  jedec-id:
    type: uint8-array
    description: expected JEDEC ID, checked at init when present

  quad:
    type: boolean
    description: |
      Read and program with four wires. The quad enable bit of the flash
      is set at init (Winbond/GigaDevice/XMC/Puya style, bit 1 of status
      register 2, or bit 6 of status register 1 for Macronix).

  dtr:
    type: boolean
    description: |
      Use the 1-4-4 double data rate read (needs 'quad', 3 byte addresses).
      The flash is probed at init (and the sample point is tuned for it);
      when it does not answer correctly the driver stays with SDR reads.
      The module clock then runs at twice the SCK for reads.

  dtr-read-opcode:
    type: int
    default: 0xee
    description: opcode of the 1-4-4 DTR read (0xee, 0xed on some parts)

  dtr-read-dummy:
    type: int
    default: 0
    description: |
      Dummy clock cycles of the DTR read, 1..12. 0 finds the count by
      trying them against known data.

  clear-block-protect:
    type: boolean
    description: |
      Clear the block protect bits of the flash at init. A protected flash
      ignores erase and program commands without reporting an error. The
      bits are non volatile: the flash stays unprotected afterwards.

  address-4byte:
    type: boolean
    description: |
      The flash is larger than 16 MiB and is addressed with four bytes.
      Derived from the capacity when absent.

  params-partition:
    type: string
    description: |
      Node label of the partition (a sector or more) that holds the tuned
      sample point. When absent tuning results cannot be saved. It is a
      name and not a phandle because a reference from the flash node to
      its own child would be a cycle in the devicetree.

  tune-partition:
    type: string
    description: |
      Node label of the partition whose first 4 KiB is read back at every
      candidate sample point to judge it; it has to hold data that is not
      constant (for example a boot image). Defaults to the start of the
      flash.

  xip-partition:
    type: string
    description: |
      Node label of the partition that is mapped to the memory window when
      the driver is configured to enable XIP at init.
```

## dts/bindings/g2d/allwinner,sunxi-g2d.yaml
```yaml
# Copyright (c) 2026 Yuzuki Tsuru
# SPDX-License-Identifier: Apache-2.0

description: |
  Allwinner G2D 2D graphics accelerator (mixer with fill, blit, blend,
  scaling and format conversion, plus a rotate/flip engine). Commands are
  queued to the hardware through a register command queue in memory.

compatible: "allwinner,sunxi-g2d"

include: base.yaml

properties:
  reg:
    required: true

  interrupts:
    required: true

  clocks:
    type: phandle-array
    required: true

  clock-names:
    type: string-array
    required: true
    description: Gates of the "mod", "bus" and "mbus" clocks, in this order.

  resets:
    type: phandle-array
    required: true

  ccu-base:
    type: int
    required: true
    description: Base address of the CCU holding the module clock register.

  mod-clk-reg:
    type: int
    required: true
    description: |
      CCU offset of the G2D module clock register (mux 26:24, divider 4:0,
      gate 31). The mux is set to PLL_PERI_2X and the divider is chosen from
      clock-frequency.

  clock-frequency:
    type: int
    default: 300000000
    description: Module clock rate in Hz.

  queue-depth:
    type: int
    default: 8
    description: Number of operations that can be queued.
```

## dts/bindings/gpio/allwinner,sunxi-gpio.yaml
```yaml
# Copyright (c) 2026 Yuzuki Tsuru
# SPDX-License-Identifier: Apache-2.0

description: |
  Allwinner sunxi PIO GPIO controller.

  Each DT gpio node covers one PIO bank (PA..PF), identified by the
  'allwinner,bank' property. The 'allwinner,pio-hw-type' property selects
  the PIO register layout used by the driver (see
  include/zephyr/drivers/pinctrl/pinctrl_sunxi.h). Bank interrupts are
  exposed as interrupt specifiers.

compatible: "allwinner,sunxi-gpio"

include: [gpio-controller.yaml, base.yaml]

properties:
  reg:
    required: true

  interrupts:
    required: true

  allwinner,pio-hw-type:
    required: true
    type: int
    description: |
      PIO hardware layout type. See
      include/zephyr/drivers/pinctrl/pinctrl_sunxi.h for the register
      layout description of each type.

  allwinner,bank:
    required: true
    type: int
    description: |
      PIO bank number of this controller (PA = 0, PB = 1, ...).

  "#gpio-cells":
    const: 2

gpio-cells:
  - pin
  - flags
```

## dts/bindings/hwinfo/allwinner,sunxi-sid.yaml
```yaml
# Copyright (c) 2026 Yuzuki Tsuru
# SPDX-License-Identifier: Apache-2.0

description: Allwinner sunxi secure ID, the one time programmable fuses of the chip

compatible: "allwinner,sunxi-sid"

include: base.yaml

properties:
  reg:
    required: true
```

## dts/bindings/i2c/allwinner,sunxi-twi.yaml
```yaml
# Copyright (c) 2026 Yuzuki Tsuru
# SPDX-License-Identifier: Apache-2.0

description: Allwinner sunxi two-wire interface controller

compatible: "allwinner,sunxi-twi"

include: [i2c-controller.yaml, pinctrl-device.yaml]

properties:
  reg:
    required: true

  clocks:
    required: true

  resets:
    type: phandle-array
    required: true

  clock-frequency:
    required: true
```

## dts/bindings/i2s/allwinner,sunxi-i2s.yaml
```yaml
# Copyright (c) 2026 Yuzuki Tsuru
# SPDX-License-Identifier: Apache-2.0

description: Allwinner sunxi I2S / PCM / TDM controller

compatible: "allwinner,sunxi-i2s"

include: [i2s-controller.yaml, pinctrl-device.yaml, base.yaml]

properties:
  reg:
    required: true

  clocks:
    required: true

  clock-names:
    required: true

  resets:
    type: phandle-array
    required: true

  clock-reg:
    type: int
    required: true
    description: Offset of the module clock register in the main CCU.

  dmas:
    required: true

  dma-names:
    required: true

  block-count:
    type: int
    default: 4
    description: Number of periods in the DMA ring of a stream.

  slot-width:
    type: int
    default: 32
    enum: [8, 12, 16, 20, 24, 28, 32]
    description: Width of one slot on the bus in bit clocks.

  mclk-fs:
    type: int
    default: 256
    description: |
      Ratio of the master clock to the frame (LRCK) rate. The master clock
      is generated from PLL_AUDIO1 (48 kHz and 44.1 kHz families).
```

## dts/bindings/i2s/allwinner,sunxi-owa.yaml
```yaml
# Copyright (c) 2026 Yuzuki Tsuru
# SPDX-License-Identifier: Apache-2.0

description: Allwinner sunxi one-wire audio (S/PDIF, IEC 60958) transmitter and receiver

compatible: "allwinner,sunxi-owa"

include: [i2s-controller.yaml, pinctrl-device.yaml, base.yaml]

properties:
  reg:
    required: true

  clocks:
    required: true

  clock-names:
    required: true

  resets:
    type: phandle-array
    required: true

  tx-clock-reg:
    type: int
    required: true
    description: Offset of the transmitter module clock register in the main CCU.

  rx-clock-reg:
    type: int
    required: true
    description: Offset of the receiver module clock register in the main CCU.

  dmas:
    required: true

  dma-names:
    required: true

  block-count:
    type: int
    default: 4
    description: Number of periods in the DMA ring of a stream.
```

## dts/bindings/input/goodix,gt967.yaml
```yaml
# Copyright (c) 2026 Yuzuki Tsuru
# SPDX-License-Identifier: Apache-2.0

description: |
  Goodix GT967 5 point capacitive touch controller. The I2C address is chosen
  by the level of the INT line while the reset is released: low selects 0x5d,
  high selects 0x14, the driver drives INT to the level that matches "reg".

compatible: "goodix,gt967"

include: [i2c-device.yaml, touchscreen-common.yaml]

properties:
  irq-gpios:
    type: phandle-array
    required: true
    description: |
      Interrupt line, a rising edge (GPIO_ACTIVE_HIGH) tells that touch data
      is ready.

  reset-gpios:
    type: phandle-array
    required: true
    description: Reset line, active low (GPIO_ACTIVE_LOW).
```

## dts/bindings/mipi-dbi/allwinner,sunxi-dbi.yaml
```yaml
# Copyright (c) 2026 Yuzuki Tsuru
# SPDX-License-Identifier: Apache-2.0

description: Allwinner sunxi DBI host controller implemented by SPI1

compatible: "allwinner,sunxi-dbi"

include: [mipi-dbi-controller.yaml, pinctrl-device.yaml]

properties:
  reg:
    required: true

  clocks:
    type: phandle-array
    required: true

  resets:
    type: phandle-array
    required: true

  clock-reg:
    type: int
    required: true
    description: CCU register offset controlling the SPI module clock.

  clock-frequency:
    type: int
    required: true
    description: Requested DBI serial clock frequency in Hz.

  spi-dev:
    type: phandle
    description: Compatibility phandle for MIPI DBI panel helper macros.

  reset-gpios:
    type: phandle-array
    description: Optional GPIO used to reset the attached display panel.

  cs-gpios:
    type: phandle-array
    description: Optional active-low GPIO used as the display CE/CS signal.

  dmas:
    type: phandle-array
    description: Optional DMA channel used for display data transfers.

  dma-names:
    type: string-array
    description: DMA channel names, including tx when dmas is present.

  "#address-cells":
    const: 1

  "#size-cells":
    const: 0
```

## dts/bindings/misc/allwinner,sunxi-mbus.yaml
```yaml
# Copyright (c) 2026 Yuzuki Tsuru
# SPDX-License-Identifier: Apache-2.0 OR GPL-2.0-or-later

description: |
  Allwinner sunxi memory bus (MBUS). Arbitrates the memory accesses of the
  bus masters (CPU, display engine, DMA, ...) and monitors their bandwidth.

  Every bus master that needs a non-default setting is a child node, named
  after the master with its number (in hex) as unit address and in reg
  (see dt-bindings/misc):

    &mbus {
            display-engine@10 {
                    reg = <SUN252I_F101_MBUS_MASTER_DE>;
                    priority = <3>;
            };

            cpu@27 {
                    reg = <SUN252I_F101_MBUS_MASTER_RISCV>;
                    bandwidth-limit-mbps = <500>;
            };
    };

compatible: "allwinner,sunxi-mbus"

include: base.yaml

properties:
  reg:
    required: true

  "#address-cells":
    const: 1

  "#size-cells":
    const: 0

  mbus-clock-mhz:
    type: int
    default: 252
    description: |
      MBUS clock in MHz, the unit of the bandwidth limit registers
      (limit register = 256 * MB/s / mbus-clock-mhz).

  pmu-window-us:
    type: int
    default: 50000
    description: Length of the bandwidth monitor window in microseconds.

child-binding:
  description: Arbitration settings of one bus master.
  properties:
    reg:
      type: int
      required: true
      description: Number of the bus master (0..39).

    priority:
      type: int
      description: Arbitration priority 0..3, 3 is the highest.

    bandwidth-limit-mbps:
      type: int
      description: Bandwidth cap of the master in MB/s.
```

## dts/bindings/pinctrl/allwinner,sunxi-pinctrl.yaml
```yaml
# Copyright (c) 2026 Yuzuki Tsuru
# SPDX-License-Identifier: Apache-2.0

description: |
  Allwinner sunxi PIO pin controller.

  Device pin configuration is placed in child nodes of this node. Each
  child node is a pin group that contains group child nodes with a
  'pinmux' array property where every element encodes a pin number and
  its muxsel function:

    pinmux = <ALLWINNER_PINMUX(port, pin, muxsel) ...>

  See include/zephyr/dt-bindings/pinctrl/allwinner-pinctrl.h for the
  macros. Optional 'bias-pull-up', 'bias-pull-down' and 'bias-disable'
  properties on a group configure the pin pull resistor.

  The 'allwinner,pio-hw-type' property selects the PIO register layout
  used by the driver (see
  include/zephyr/drivers/pinctrl/pinctrl_sunxi.h).

  Example:

    #include <zephyr/dt-bindings/pinctrl/allwinner-pinctrl.h>

    &pio {
      uart1_pins: uart1_pins {
        uart1_pins_group {
          pinmux = <ALLWINNER_PINMUX(ALLWINNER_PIO_PF, 0, 4)
                    ALLWINNER_PINMUX(ALLWINNER_PIO_PF, 1, 4)>;
        };
      };
    };

compatible: "allwinner,sunxi-pinctrl"

include: base.yaml

properties:
  reg:
    required: true

  allwinner,pio-hw-type:
    required: true
    type: int
    description: |
      PIO hardware layout type. See
      include/zephyr/drivers/pinctrl/pinctrl_sunxi.h for the register
      layout description of each type.

child-binding:
  description: PIO pin group node.
  child-binding:
    description: Pin configuration node.
    properties:
      pinmux:
        required: true
        type: array
        description: |
          Pin functions, one cell per pin. Each cell encodes the pin number
          and the muxsel function.
      bias-pull-up:
        type: boolean
        description: Enable internal pull-up.
      bias-pull-down:
        type: boolean
        description: Enable internal pull-down.
      bias-disable:
        type: boolean
        description: Disable the internal pull resistor.
      allwinner,drive-level:
        type: int
        description: |
          Pad drive level (0..3), applied by the pinctrl driver when
          present; the reset value is kept otherwise. The display pipeline
          also reads it for its LVDS/DSI lanes.
```
