## dts/bindings/pwm/allwinner,sunxi-pwm-bl.yaml
```yaml
# Copyright (c) 2026 Yuzuki Tsuru
# SPDX-License-Identifier: Apache-2.0

description: |
  Allwinner PWM_BL backlight controller (digital dimming + analog current
  sink). Single logical channel 0; the duty is mapped to a load current
  reference.

compatible: "allwinner,sunxi-pwm-bl"

include: [pwm-controller.yaml, pinctrl-device.yaml, base.yaml]

properties:
  reg:
    required: true

  "#pwm-cells":
    const: 3

  ccu-base:
    type: int
    required: true
    description: Base address of the CCU holding the module clock registers.

  mod-clk-reg:
    type: int
    required: true
    description: CCU offset of the PWM_BL module clock register.

  bus-clk-reg:
    type: int
    required: true
    description: CCU offset of the PWM_BL bus gate / reset register.

pwm-cells:
  - channel
  - period
  - flags
```

## dts/bindings/pwm/allwinner,sunxi-pwm.yaml
```yaml
# Copyright (c) 2026 Yuzuki Tsuru
# SPDX-License-Identifier: Apache-2.0

description: Allwinner sunxi PWM-ng controller

compatible: "allwinner,sunxi-pwm"

include: [pwm-controller.yaml, base.yaml, reset-device.yaml, pinctrl-device.yaml]

properties:
  reg:
    required: true

  clocks:
    required: true

  resets:
    required: true

  channels:
    type: int
    const: 4

  "#pwm-cells":
    const: 3

pwm-cells:
  - channel
  - period
  - flags
```

## dts/bindings/reset/allwinner,sunxi-rctl.yaml
```yaml
# Copyright (c) 2026 Yuzuki Tsuru
# SPDX-License-Identifier: Apache-2.0

description: |
  Allwinner sunxi CCU reset controller.

  This binding covers the reset lines in the system CCU. The reset id
  encodes the CCU base index, the register offset and the reset bit
  position:

    id = (base_index << 20) | (reg_offset << 8) | bit

  The CCU base addresses are taken from the 'ccu-bases' property of the
  parent CCU node. Predefined ids are available in the SoC ccu header,
  e.g. include/zephyr/dt-bindings/clock/sun252i-f101-ccu.h.

compatible: "allwinner,sunxi-rctl"

include: [reset-controller.yaml, base.yaml]

properties:
  "#reset-cells":
    const: 1

reset-cells:
  - id
```

## dts/bindings/sdhc/allwinner,sunxi-smhc.yaml
```yaml
# Copyright (c) 2026 Yuzuki Tsuru
# SPDX-License-Identifier: Apache-2.0

description: Allwinner sunxi SD/MMC host controller (SMHC)

compatible: "allwinner,sunxi-smhc"

include: [sdhc.yaml, pinctrl-device.yaml]

properties:
  reg:
    required: true

  interrupts:
    required: true

  clocks:
    required: true

  clock-names:
    required: true

  resets:
    type: phandle-array
    required: true

  clock-reg:
    type: int
    required: true
    description: |
      Offset of the module clock register (source select, divider and gate)
      in the main CCU.

  bus-width:
    type: int
    default: 4
    enum: [1, 4, 8]
    description: Number of data lines wired to the slot.

  cd-gpios:
    type: phandle-array
    description: |
      Card detect GPIO. Use GPIO_ACTIVE_LOW when the line is low with a card
      inserted.

  pwr-gpios:
    type: phandle-array
    description: GPIO enabling the card supply (optional).

  non-removable:
    type: boolean
    description: The card is soldered (eMMC, SDIO module); always present.
```

## dts/bindings/spi/allwinner,sunxi-spi.yaml
```yaml
# Copyright (c) 2026 Yuzuki Tsuru
# SPDX-License-Identifier: Apache-2.0

description: Allwinner sunxi SPI controller

compatible: "allwinner,sunxi-spi"

include: [spi-controller.yaml, pinctrl-device.yaml]

properties:
  reg:
    required: true

  clocks:
    required: true

  clock-names:
    required: true

  resets:
    type: phandle-array
    required: true

  clock-frequency:
    type: int
    required: true

  clock-reg:
    type: int
    required: true

  dmas:
    description: |
      Optional DMA channel for the receive data of long reads ("rx"). The
      FIFO is drained by the DMA in 32 bit units; what is left below the
      FIFO trigger level at the end of a transfer is read by the CPU.

  dma-names:
    description: '"rx"'

  dma-slot:
    type: int
    description: request line (DRQ) of the SPI receive FIFO
```

## dts/bindings/usb/allwinner,sunxi-ehci.yaml
```yaml
# Copyright (c) 2026 Yuzuki Tsuru
# SPDX-License-Identifier: Apache-2.0

description: |
  Allwinner sunxi USB 2.0 host controllers: an EHCI controller and the OHCI
  companion that serves low and full speed devices. They share the UTMI PHY
  with the OTG device controller.

compatible: "allwinner,sunxi-ehci"

include: [base.yaml, reset-device.yaml]

properties:
  reg:
    required: true

  reg-names:
    required: true

  interrupts:
    required: true

  interrupt-names:
    required: true

  clocks:
    type: phandle-array
    required: true

  clock-names:
    type: string-array
    required: true
    description: Bus gates of the "ehci" and "ohci" blocks, in this order.

  phys:
    type: phandle-array
    required: true
    description: UTMI PHY used by the controllers.
```

## dts/bindings/usb/allwinner,sunxi-musb.yaml
```yaml
# Copyright (c) 2026 Yuzuki Tsuru
# SPDX-License-Identifier: Apache-2.0

description: |
  Allwinner sunxi USB 2.0 OTG controller (Mentor MUSB core with an indexed
  endpoint register window and dynamic FIFO sizing), device mode.

compatible: "allwinner,sunxi-musb"

include: [base.yaml, reset-device.yaml]

properties:
  reg:
    required: true

  interrupts:
    required: true

  clocks:
    type: phandle-array
    required: true

  phys:
    type: phandle-array
    required: true
    description: UTMI PHY used by the controller.
```

## dts/bindings/usb/allwinner,sunxi-usb-phy.yaml
```yaml
# Copyright (c) 2026 Yuzuki Tsuru
# SPDX-License-Identifier: Apache-2.0

description: |
  Allwinner sunxi USB 2.0 UTMI PHY. One PHY is shared by the OTG (device)
  controller and the EHCI/OHCI host controllers; the controller that uses it is
  selected by software, and the PHY driver supplies VBUS to a host.

compatible: "allwinner,sunxi-usb-phy"

include: phy-controller.yaml

properties:
  reg:
    required: true
    description: |
      Two register blocks: the PHY glue in the OTG window and the PHY/SIE
      block in the host controller window.

  reg-names:
    required: true

  clocks:
    type: phandle-array
    required: true
    description: USB bus gate that also clocks the PHY.

  resets:
    type: phandle-array
    required: true
    description: PHY reset line.

  sram-remap-reg:
    type: int
    description: |
      Address of the system register whose bits give the USB controller the
      FIFO RAM.

  sram-remap-clear:
    type: int
    description: Bits cleared in sram-remap-reg to hand the RAM to the USB controller.

  vbus-gpios:
    type: phandle-array
    description: GPIO that drives VBUS, active while a host controller runs.
```

## dts/bindings/video/allwinner,sunxi-ve.yaml
```yaml
# Copyright (c) 2026 Yuzuki Tsuru
# SPDX-License-Identifier: Apache-2.0

description: Allwinner sunxi video engine (JPEG, PNG and H.264 decoder)

compatible: "allwinner,sunxi-ve"

include: base.yaml

properties:
  reg:
    required: true

  interrupts:
    required: true

  clocks:
    required: true

  clock-names:
    required: true

  resets:
    type: phandle-array
    required: true

  clock-reg:
    type: int
    required: true
    description: |
      Offset of the module clock register (source select, divider and gate)
      in the main CCU.

  sram-ctrl-reg:
    type: int
    required: true
    description: |
      Base of the system control block holding the SRAM ownership bits that
      hand the shared SRAM to the video engine.
```

## dts/bindings/watchdog/allwinner,sunxi-wdt.yaml
```yaml
# Copyright (c) 2026 Yuzuki Tsuru
# SPDX-License-Identifier: Apache-2.0

description: Allwinner sunxi RISC-V watchdog

compatible: "allwinner,sunxi-wdt"

include: base.yaml

properties:
  reg:
    required: true
```

## lib/helix_aac/Kconfig
```kconfig
# Copyright (c) 2026 Yuzuki Tsuru
# SPDX-License-Identifier: Apache-2.0

config HELIX_AAC
	bool "Helix AAC decoder"
	help
	  Fixed-point AAC-LC / HE-AAC decoder (west project modules/lib/libhelix,
	  integer only, no floating point or libm needed).

config HELIX_AAC_SBR
	bool "Helix AAC: spectral band replication (HE-AAC)"
	depends on HELIX_AAC
	help
	  Decode HE-AAC streams at the full output rate. The output buffer then
	  holds 2048 samples per channel per frame instead of 1024.
```

## lib/mp4/Kconfig
```kconfig
# Copyright (c) 2026 Yuzuki Tsuru
# SPDX-License-Identifier: Apache-2.0

config MP4_DEMUX
	bool "MP4 demultiplexer"
	help
	  Sample tables and sample iterator for the H.264 and AAC tracks of an
	  MP4 / ISO base media file.
```

## lib/opencore_aac/Kconfig
```kconfig
# Copyright (c) 2026 Yuzuki Tsuru
# SPDX-License-Identifier: Apache-2.0

config OPENCORE_AAC
	bool "OpenCORE AAC decoder"
	help
	  Fixed-point AAC-LC / HE-AAC decoder of the OpenCORE multimedia
	  framework (west project modules/lib/opencore, Apache-2.0). Integer
	  only, no libm. The decoder sources are C written in .cpp files and are
	  built as C.
```
