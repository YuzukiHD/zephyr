## dts/bindings/display/sunxi/panel-dsi.yaml
```yaml
# Copyright (c) 2026 Yuzuki Tsuru
# SPDX-License-Identifier: Apache-2.0

description: MIPI DSI panel driven by the display pipeline.

compatible: "panel-dsi"

include: panel-common.yaml

properties:
  data-lanes:
    type: array
    required: true
    description: DSI data lanes, one cell per lane.

  mipi-dsi-format:
    type: string
    required: true
    enum:
      - "rgb888"
      - "rgb666"
      - "rgb666-packed"
      - "rgb565"

  mode-flags:
    type: int
    default: 0
    description: SUNXI_DSI_MODE_* flags.

  hs-trail:
    type: int
    default: 0

  clk-trail:
    type: int
    default: 0
```

## dts/bindings/display/sunxi/panel-simple.yaml
```yaml
# Copyright (c) 2026 Yuzuki Tsuru
# SPDX-License-Identifier: Apache-2.0

description: Simple RGB or LVDS panel driven by the display pipeline.

compatible: "panel-simple"

include: panel-common.yaml

properties:
  bus-format:
    type: string
    required: true
    enum:
      - "rgb888-1x24"
      - "rgb666-1x18"
      - "rgb565-1x16"
      - "rgb666-1x7x3-spwg"
      - "rgb888-1x7x4-spwg"
      - "rgb888-1x7x4-jeida"
    description: Pixel format on the wire between the encoder and the panel.

  spi-mode:
    type: string
    enum:
      - "none"
      - "3wire-9bit"
      - "4wire-8bit"
    default: "none"
    description: Bit-banged SPI used by init-sequence SPI commands.

  spi-cs-gpios:
    type: phandle-array

  spi-sck-gpios:
    type: phandle-array

  spi-sda-gpios:
    type: phandle-array

  spi-dc-gpios:
    type: phandle-array

  spi-half-period-us:
    type: int
    default: 1
```

## dts/bindings/display/sunxi/pwm-backlight.yaml
```yaml
# Copyright (c) 2026 Yuzuki Tsuru
# SPDX-License-Identifier: Apache-2.0

description: PWM dimmed panel backlight with an optional enable GPIO.

compatible: "pwm-backlight"

include: base.yaml

properties:
  pwms:
    type: phandle-array
    required: true
    description: PWM channel, period in ns and flags (PWM_POLARITY_*).

  max-level:
    type: int
    default: 255

  default-level:
    type: int
    default: 255

  min-level:
    type: int
    default: 0
    description: Minimum duty (level 1) in 1/max-level units.

  enable-gpios:
    type: phandle-array
    description: Optional GPIO switching the backlight supply.
```

## dts/bindings/display/sunxi/sunxi-display-common.yaml
```yaml
# Copyright (c) 2026 Yuzuki Tsuru
# SPDX-License-Identifier: Apache-2.0

# Properties shared by the blocks of the Allwinner display pipeline.

include: base.yaml

properties:
  clocks:
    type: phandle-array
    description: Clocks of the block, in the order of clock-names.

  clock-names:
    type: string-array
    description: Clock names, "mod" (module) and "bus".

  clock-parents:
    type: array
    description: |
      Parent clock id for each entry of clocks (0 = leave as is). The clock
      is switched to this parent before its rate is set.

  clock-rates:
    type: array
    description: Rate in Hz for each entry of clocks (0 = leave as is).

  resets:
    type: phandle-array
    description: Reset lines of the block, in the order of reset-names.

  reset-names:
    type: string-array
    description: Reset names, "bus".
```

## dts/bindings/display/sunxi/sunxi-display-ports.yaml
```yaml
# Copyright (c) 2026 Yuzuki Tsuru
# SPDX-License-Identifier: Apache-2.0

# Output graph of a display pipeline block:
#
#   ports {
#           #address-cells = <1>;
#           #size-cells = <0>;
#           port@1 {
#                   reg = <1>;
#                   #address-cells = <1>;
#                   #size-cells = <0>;
#                   endpoint@0 {
#                           reg = <0>;
#                           remote-endpoint = <&sink>;
#                   };
#           };
#   };
#
# A link is described once, on the source side; the driver treats it as
# an undirected connection between (node, port, endpoint) pairs.

include: sunxi-display-common.yaml

child-binding:
  description: Output ports of the block.
  child-binding:
    description: Port, numbered by reg.
    properties:
      reg:
        type: int
        required: true
    child-binding:
      description: Endpoint, numbered by reg, connecting to a sink node.
      properties:
        reg:
          type: int
          required: true
        remote-endpoint:
          type: phandle
          required: true
          description: Sink node the endpoint is connected to.
        remote-port:
          type: int
          default: 0
          description: Port of the sink node.
        remote-ep:
          type: int
          default: 0
          description: Endpoint of the sink port.
```
