## drivers/usb/phy/Kconfig
```kconfig
# Copyright (c) 2026 Yuzuki Tsuru
# SPDX-License-Identifier: Apache-2.0

config USB_PHY_SUNXI
	bool "Allwinner sunxi USB 2.0 PHY driver"
	default y
	depends on DT_HAS_ALLWINNER_SUNXI_USB_PHY_ENABLED
	depends on CLOCK_CONTROL && RESET && GPIO
	help
	  Clock, reset and routing of the UTMI PHY shared by the OTG device
	  controller and the host controllers.

if USB_PHY_SUNXI

config USB_PHY_SUNXI_INIT_PRIORITY
	int "PHY init priority"
	default 40
	help
	  Must come before the controllers that use the PHY.

module = USB_PHY_SUNXI
module-str = usb phy sunxi
source "subsys/logging/Kconfig.template.log_config"

endif # USB_PHY_SUNXI
```

## drivers/vdec/Kconfig
```kconfig
# Copyright (c) 2026 Yuzuki Tsuru
# SPDX-License-Identifier: Apache-2.0

menuconfig VDEC
	bool "Hardware image and video decoders"
	help
	  Include drivers for hardware JPEG, PNG and H.264 decoders.

if VDEC

config VDEC_INIT_PRIORITY
	int "Decoder driver init priority"
	default 90
	help
	  Initialisation priority of the decoder drivers.

source "drivers/vdec/sunxi/Kconfig"

endif # VDEC
```

## drivers/vdec/sunxi/Kconfig
```kconfig
# SPDX-License-Identifier: Apache-2.0

config VDEC_SUNXI
	bool "Allwinner sunxi video engine decoder"
	default y
	depends on DT_HAS_ALLWINNER_SUNXI_VE_ENABLED
	depends on FPU
	select CACHE_MANAGEMENT
	help
	  Baseline JPEG and H.264 decoding on the sunxi video engine and a
	  software PNG decoder, all in C. ve_hw.c drives the engine (clock,
	  reset, interrupt, picture conversion), ve_pool.c and ve_stream.c hold
	  the pictures and the compressed data, ve_session.c ties them to a
	  codec (ve_jpeg.c, ve_h264.c, ve_png.c).

if VDEC_SUNXI

config VDEC_SUNXI_JPEG
	bool "JPEG decoder"
	default y
	help
	  Markers are read in software (ve_jpeg_parse.c) and the engine
	  registers are programmed by ve_jpeg_hw.c.

config VDEC_SUNXI_PNG
	bool "PNG decoder"
	default y
	select CRC
	help
	  Software PNG decoder (all colour types and bit depths, tRNS, Adam7);
	  the picture is delivered as RGBA8888.

config VDEC_SUNXI_H264
	bool "H.264 decoder"
	default y
	help
	  Syntax, reference pictures and the engine programming are in
	  drivers/vdec/sunxi/ve_h264*.c. Frame pictures only (no field or
	  macroblock adaptive coding).

config VDEC_SUNXI_RVV
	bool "Use the vector extension in the loops the CPU runs"
	default y
	depends on SUN252I_F101_RVV
	help
	  Vector versions of the byte loops on the CPU side of the decoders:
	  the filters, checksum and pixel conversion of the PNG decoder, the
	  chroma swap of NV21 pictures and the search for H.264 start codes.
	  The decoding itself is done by the engine and does not change.

config VDEC_SUNXI_H264_DIRECT_NV12
	bool "H.264: the engine writes the linear picture itself (experimental)"
	depends on VDEC_SUNXI_H264
	help
	  Besides the tiled picture it keeps as reference, the decoder writes a
	  copy as linear NV12 through its second output, so no separate
	  conversion pass is needed.

config VDEC_SUNXI_H264_DIRECT_CHECK
	bool "Compare the direct picture with the converted one"
	depends on VDEC_SUNXI_H264_DIRECT_NV12
	help
	  For the first pictures of a stream also run the conversion and print
	  how many bytes of the two linear pictures differ.

config VDEC_SUNXI_MEM_TRACE
	bool "Print every picture/work buffer allocation"

config VDEC_SUNXI_CLOCK_MHZ
	int "Video engine clock in MHz"
	default 300
	help
	  Target rate of the module clock. The nearest rate the clock divider
	  can produce below the source rate is used.

config VDEC_SUNXI_STREAM_BUFFER_KB
	int "Size of the compressed data buffer in KiB"
	default 512
	range 64 32768
	help
	  Room for compressed pictures waiting for the decoder. A single JPEG
	  or PNG has to fit; an application can ask for more at open time.

config VDEC_SUNXI_MAX_MEMORY_KB
	int "Memory budget of one decoder in KiB"
	default 12288
	help
	  Upper bound the decoders may use for pictures and stream buffer; it
	  decides how many frame buffers a stream gets (never fewer than the
	  H.264 references plus three).

config VDEC_SUNXI_MEM_ALIGN
	int "Alignment of decoder buffers"
	default 4096
	help
	  Alignment of every buffer handed to the video engine.

config VDEC_SUNXI_LOG_LEVEL
	int "Log level of the video engine driver"
	default 3

endif # VDEC_SUNXI
```

## drivers/watchdog/Kconfig.sunxi
```kconfig
# Copyright (c) 2026 Yuzuki Tsuru
# SPDX-License-Identifier: Apache-2.0

config WDT_SUNXI
	bool "Allwinner sunxi watchdog"
	default y
	depends on DT_HAS_ALLWINNER_SUNXI_WDT_ENABLED
	select HAS_WDT_NO_CALLBACKS
	select HAS_WDT_DISABLE_AT_BOOT
	help
	  Enable the single-channel Allwinner sunxi watchdog in SoC-reset mode.

config WDT_SUNXI_INIT_PRIORITY
	int "Allwinner sunxi watchdog init priority"
	default 80
```

## dts/bindings/adc/allwinner,sunxi-gpadc.yaml
```yaml
# Copyright (c) 2026 Yuzuki Tsuru
# SPDX-License-Identifier: Apache-2.0

description: Allwinner sunxi GPADC controller

compatible: "allwinner,sunxi-gpadc"

include: [adc-controller.yaml, base.yaml, reset-device.yaml]

properties:
  reg:
    required: true

  clocks:
    required: true

  resets:
    required: true

  channels:
    type: int
    const: 12

  vref-mv:
    type: int
    const: 1800

  sample-rate:
    type: int
    default: 1000
    description: ADC conversion rate in samples per second.

  read-timeout-us:
    type: int
    default: 10000
    description: Maximum time to wait for one conversion result.

  "#io-channel-cells":
    const: 1

io-channel-cells:
  - input
```

## dts/bindings/audio/allwinner,sunxi-codec-analog.yaml
```yaml
# Copyright (c) 2026 Yuzuki Tsuru
# SPDX-License-Identifier: Apache-2.0

description: |
  Analog part of the Allwinner sunxi on-chip audio codec (headphone driver,
  microphone / line / FM input stage, speaker amplifier enable). Child of the
  "allwinner,sunxi-codec" node, its registers are in the parent's space.

compatible: "allwinner,sunxi-codec-analog"

include: base.yaml

properties:
  pa-gpios:
    type: phandle-array
    description: |
      Enable line of the external speaker power amplifier, driven high while
      the output is on.

  pa-delay-ms:
    type: int
    default: 10
    description: Time between the amplifier enable and the start of the output.

  hpout-gain:
    type: int
    default: 7
    description: Headphone driver gain, 0 (lowest) to 7.

  dac-volume:
    type: int
    default: 130
    description: Digital DAC volume of both channels, 0 to 255.

  adc-volume:
    type: int
    default: 160
    description: Digital ADC volume, 0 to 255.

  adc-gain:
    type: int
    default: 15
    description: Microphone PGA gain, 0 to 15.

  adc-source:
    type: string
    default: "mic"
    enum:
      - "mic"
      - "fmin"
      - "linein"
      - "none"
    description: Analog input routed to the ADC.
```

## dts/bindings/audio/allwinner,sunxi-codec.yaml
```yaml
# Copyright (c) 2026 Yuzuki Tsuru
# SPDX-License-Identifier: Apache-2.0

description: |
  Allwinner sunxi on-chip audio codec: the digital DAC/ADC FIFOs with their
  DMA streams. The stream side is an I2S device (TX is the DAC, RX the ADC),
  the analog front end is the "analog" child node.

compatible: "allwinner,sunxi-codec"

include: base.yaml

properties:
  reg:
    required: true

  clocks:
    required: true

  clock-names:
    required: true

  resets:
    type: phandle-array
    required: true

  dac-clock-reg:
    type: int
    required: true
    description: Offset of the DAC module clock register in the main CCU.

  adc-clock-reg:
    type: int
    required: true
    description: Offset of the ADC module clock register in the main CCU.

  dmas:
    required: true

  dma-names:
    required: true

  block-count:
    type: int
    default: 4
    description: |
      Number of periods in the DMA ring of a stream. Each period is one
      block of the configured I2S memory slab.
```

## dts/bindings/clock/allwinner,sunxi-cctl.yaml
```yaml
# Copyright (c) 2026 Yuzuki Tsuru
# SPDX-License-Identifier: Apache-2.0

description: |
  Allwinner sunxi CCU bus clock controller.

  This binding covers the bus clock gates in the system CCU. The clock id
  encodes the CCU base index, the register offset and the gate bit
  position:

    clkid = (base_index << 20) | (reg_offset << 8) | bit

  The CCU base addresses are taken from the 'ccu-bases' property of the
  parent CCU node. Predefined ids are available in the SoC ccu header,
  e.g. include/zephyr/dt-bindings/clock/sun252i-f101-ccu.h.

  The optional 'apb-uart-reg', 'pll-peri-reg' and 'uart-bgr-reg'
  properties enable rate reporting for the UART bus clocks: any clock
  whose gate register offset equals 'uart-bgr-reg' is reported at the
  APB_UART clock rate, computed from the standard sunxi APB_UART mux and
  PLL_PERI registers in the main CCU.

compatible: "allwinner,sunxi-cctl"

include: [clock-controller.yaml, base.yaml]

properties:
  apb-uart-reg:
    type: int
    description: |
      APB_UART mux/divider register offset in the main CCU. Enables rate
      reporting for the UART bus clocks.
  pll-peri-reg:
    type: int
    description: |
      PLL_PERI control register offset in the main CCU.
  uart-bgr-reg:
    type: int
    description: |
      UART bus gate/reset register offset in the main CCU. Clocks in
      this register are reported at the APB_UART clock rate.

  "#clock-cells":
    const: 1

clock-cells:
  - clkid
```

## dts/bindings/clock/allwinner,sunxi-ccu.yaml
```yaml
# Copyright (c) 2026 Yuzuki Tsuru
# SPDX-License-Identifier: Apache-2.0

description: |
  Allwinner sunxi CCU (clock control unit) block.

  The block hosts the bus clock gates and reset lines for a set of
  peripherals. The base addresses listed in 'ccu-bases' are indexed by
  the base index field of the clock and reset ids (see
  include/zephyr/dt-bindings/clock/allwinner-ccu.h).

compatible: "allwinner,sunxi-ccu"

include: base.yaml

properties:
  ccu-bases:
    required: true
    type: array
    description: |
      CCU base addresses, indexed by the base index field of the clock
      and reset ids. The first entry is the main CCU, followed by the
      R_CCU, RTC_CCU, ...
```

## dts/bindings/cpu/xuantie,c907.yaml
```yaml
# Copyright (c) 2026 Yuzuki Tsuru
# SPDX-License-Identifier: Apache-2.0

description: Xuantie C907 Core CPU

compatible: "xuantie,c907"

include: riscv,cpus.yaml

properties:
  hardware-exec-breakpoint-count:
    type: int
    description: Number of hardware break points
```

## dts/bindings/display/allwinner,sunxi-display.yaml
```yaml
# Copyright (c) 2026 Yuzuki Tsuru
# SPDX-License-Identifier: Apache-2.0

description: |
  Allwinner display engine + TCON display pipeline root. The blocks of the
  pipeline (display engine, TCON, encoders, D-PHY, panel, backlight) are
  separate nodes described by their own bindings; the driver walks all
  enabled ones. This node makes the pipeline visible as a Zephyr display
  device and gives the size of the framebuffer.

compatible: "allwinner,sunxi-display"

include: base.yaml

properties:
  height:
    type: int
    description: Height of the framebuffer in pixels.

  width:
    type: int
    description: Width of the framebuffer in pixels.
```

## dts/bindings/display/sunxi/allwinner,sun252iw2-combo-dphy.yaml
```yaml
# Copyright (c) 2026 Yuzuki Tsuru
# SPDX-License-Identifier: Apache-2.0

description: Allwinner F101 combo D-PHY shared by the DSI and LVDS outputs.

compatible: "allwinner,sun252iw2-combo-dphy"

include: sunxi-display-common.yaml

properties:
  reg:
    required: true
```

## dts/bindings/display/sunxi/allwinner,sun252iw2-display-engine.yaml
```yaml
# Copyright (c) 2026 Yuzuki Tsuru
# SPDX-License-Identifier: Apache-2.0

description: Allwinner F101 display engine 2.x (mixer, planes, blender).

compatible: "allwinner,sun252iw2-display-engine"

include: sunxi-display-ports.yaml

properties:
  reg:
    required: true

  brightness:
    type: int
    default: 50
    description: Colour adjustment, 0..100 (50 is neutral).

  contrast:
    type: int
    default: 50

  saturation:
    type: int
    default: 50

  hue:
    type: int
    default: 50

  background-color:
    type: int
    default: 0
    description: Colour shown where no plane covers the screen, 0xRRGGBB.
```

## dts/bindings/display/sunxi/allwinner,sun252iw2-mipi-dsi.yaml
```yaml
# Copyright (c) 2026 Yuzuki Tsuru
# SPDX-License-Identifier: Apache-2.0

description: Allwinner F101 MIPI DSI host (uses the combo D-PHY).

compatible: "allwinner,sun252iw2-mipi-dsi"

include: [sunxi-display-ports.yaml, pinctrl-device.yaml]

properties:
  reg:
    required: true

  interrupts:
    required: true

  phy:
    type: phandle
    required: true
    description: Combo D-PHY of the DSI link.
```

## dts/bindings/display/sunxi/allwinner,sun252iw2-tcon-lcd.yaml
```yaml
# Copyright (c) 2026 Yuzuki Tsuru
# SPDX-License-Identifier: Apache-2.0

description: Allwinner F101 LCD timing controller (TCON LCD).

compatible: "allwinner,sun252iw2-tcon-lcd"

include: sunxi-display-ports.yaml

properties:
  reg:
    required: true

  interrupts:
    required: true

  top:
    type: phandle
    required: true
    description: Display interface top block of the TCON.
```

## dts/bindings/display/sunxi/allwinner,sun252iw2-tcon-top.yaml
```yaml
# Copyright (c) 2026 Yuzuki Tsuru
# SPDX-License-Identifier: Apache-2.0

description: Allwinner F101 display interface top (clock and route glue of the TCON).

compatible: "allwinner,sun252iw2-tcon-top"

include: sunxi-display-common.yaml

properties:
  reg:
    required: true
```

## dts/bindings/display/sunxi/allwinner,sunxi-lvds.yaml
```yaml
# Copyright (c) 2026 Yuzuki Tsuru
# SPDX-License-Identifier: Apache-2.0

description: Allwinner LVDS output of the TCON LCD (uses the combo D-PHY).

compatible: "allwinner,sunxi-lvds"

include: [sunxi-display-ports.yaml, pinctrl-device.yaml]

properties:
  resets:
    required: true

  phy:
    type: phandle
    required: true
    description: Combo D-PHY of the LVDS link.

  dual-link:
    type: boolean
    description: Drive two LVDS links.

  use-tcon-frm:
    type: boolean
```

## dts/bindings/display/sunxi/allwinner,sunxi-rgb.yaml
```yaml
# Copyright (c) 2026 Yuzuki Tsuru
# SPDX-License-Identifier: Apache-2.0

description: Allwinner parallel RGB (HV) output of the TCON LCD.

compatible: "allwinner,sunxi-rgb"

include: [sunxi-display-ports.yaml, pinctrl-device.yaml]

properties:
  hv-mode:
    type: int
    default: 0
    description: SUNXI_HV_* interface mode.

  serial-rgb-sequence:
    type: int
    default: 0

  serial-yuv-sequence:
    type: int
    default: 0

  serial-yuv-first-delay:
    type: int
    default: 0

  rgb-swap:
    type: int
    default: 0
    description: Output colour component permutation (TCON RGB_SWAP).

  rb-swap:
    type: int
    default: 0

  clk-phase:
    type: int
    default: 0
    description: 0..3, dclk delay/invert selection.

  use-tcon-frm:
    type: boolean
    description: Dither in the TCON (FRM) for panels narrower than 8 bit.

  io-adjust:
    type: int
    default: 0
```

## dts/bindings/display/sunxi/gpio-backlight.yaml
```yaml
# Copyright (c) 2026 Yuzuki Tsuru
# SPDX-License-Identifier: Apache-2.0

description: On/off panel backlight driven by a GPIO.

compatible: "gpio-backlight"

include: base.yaml

properties:
  enable-gpios:
    type: phandle-array
    required: true
```
